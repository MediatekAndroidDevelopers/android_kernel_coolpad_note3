## drivers/misc/mediatek/accelerometer/bma250-new/Kconfig
```kconfig
config MTK_BMA250_NEW
	bool "BMA250 for MediaTek package"
	default n
	help
	  It support different accelerometer sensor.
          If this option is set,
	  it will support
          BMA250 Accelerometer.
```

## drivers/misc/mediatek/accelerometer/n2dm-new/Kconfig
```kconfig
config MTK_N2DM_NEW
	bool "N2DM for MediaTek package"
	default n
	help
	  It support different accelerometer sensor.
          If this option is set,
	  it will support
          N2DM Accelerometer.
```

## drivers/misc/mediatek/alsps/ltr559-new/Kconfig
```kconfig
config MTK_LTR559_NEW
	bool "ltr559 for MediaTek package"
	default n
	help
	It support different type sensor
	in this platform. If this option
	is set, it will support ambient
	and light sensor ltr559.
```

## drivers/misc/mediatek/alsps/pa12200001/Kconfig
```kconfig
config MTK_PA12200001
	bool "PA12200001 for MediaTek package"
	default n
	help
	It support different type sensor
	in this platform. If this option
	is set, it will support ambient
	and light sensor PA12200001.
```

## drivers/misc/mediatek/gyroscope/lsm6ds3gy-new/Kconfig
```kconfig
config MTK_LSM6DS3GY_NEW
        bool "lsm6ds3gy for MediaTek package"
        default n
        help
        It support different gyroscope sensor.
        If this option is set,
	  	it will support
         lsm6ds3gy gyroscope.
```

## drivers/misc/mediatek/imgsensor/Kconfig
```kconfig
config MTK_IMGSENSOR
  bool CONFIG_MTK_IMGSENSOR
  default n
  help
    CONFIG_MTK_IMGSENSOR

config YL_CAM_MODULE_NAME
  bool CONFIG_YL_CAM_MODULE_NAME
  default n
  help
    CONFIG_YL_CAM_MODULE_NAME
```

## drivers/misc/mediatek/magnetometer/yamaha537-new/Kconfig
```kconfig
config MTK_YAS537_NEW
	bool "YAMAHA537 for MediaTek package"
	default n
	help
	  It support different magnetometer sensor.
          If this option is set,
	  it will support
          YAMAHA537 magnetometer.
```

## drivers/peripherals/Kconfig
```kconfig
#
# zyt_peripherals configuration
#
config ZYT_PERIPHERALS
           tristate "ZYT Pheripherals Driver"
           default y
           help
           This is the zyt pheripherals driver.
```
