/*
 * Mediatek's LCM driver device tree
 *
 * Copyright (c) 2013 MediaTek Co., Ltd.
 *              http://www.mediatek.com
 *
 */

#include "lcm_define.h"

/ {
	/* LCM standardization */
	lcm_params_5 {
		compatible = "mediatek,lcm_params-r63315_tianma_tm";

		lcm_params-lcd_type = "LCD_TYPE_R63315_TIANMA_FHD_1080";
		lcm_params-types = <2 0 0 0>;
		/* type, ctrl, lcm_if, lcm_cmd_if */
		lcm_params-resolution = <1080 1920>;
		/* width, height */
		lcm_params-io_select_mode;

		lcm_params-dbi-port;
		lcm_params-dbi-clock_freq;
		lcm_params-dbi-data_width;
		lcm_params-dbi-data_format;
		/* color_order, trans_seq, padding, format, width */
		lcm_params-dbi-cpu_write_bits;
		lcm_params-dbi-io_driving_current;
		lcm_params-dbi-msb_io_driving_current;
		lcm_params-dbi-ctrl_io_driving_current;

		lcm_params-dbi-te_mode;
		lcm_params-dbi-te_edge_polarity;
		lcm_params-dbi-te_hs_delay_cnt;
		lcm_params-dbi-te_vs_width_cnt;
		lcm_params-dbi-te_vs_width_cnt_div;

		lcm_params-dbi-serial-params0;
		/* cs_polarity, clk_polarity, clk_phase, is_non_dbi_mode, clock_base, clock_div */
		lcm_params-dbi-serial-params1;
		/* css, csh, rd_1st, rd_2nd, wr_1st, wr_2nd */
		lcm_params-dbi-serial-params2;
		/* sif_1st_pol, sif_sck_def, sif_3wire, sif_sdi sif_div2, sif_hw_cs */
		lcm_params-dbi-parallel-params0;
		/* write_setup, write_hold, write_wait, read_setup */
		lcm_params-dbi-parallel-params1;
		/* read_hold, read_latency, wait_period, cs_high_width */

		lcm_params-dpi-mipi_pll_clk_ref;
		lcm_params-dpi-mipi_pll_clk_div1;
		lcm_params-dpi-mipi_pll_clk_div2;
		lcm_params-dpi-mipi_pll_clk_fbk_div;

		lcm_params-dpi-dpi_clk_div;
		lcm_params-dpi-dpi_clk_duty;
		lcm_params-dpi-PLL_CLOCK;
		lcm_params-dpi-dpi_clock;
		lcm_params-dpi-ssc_disable;
		lcm_params-dpi-ssc_range;

		lcm_params-dpi-width;
		lcm_params-dpi-height;
		lcm_params-dpi-bg_width;
		lcm_params-dpi-bg_height;

		lcm_params-dpi-clk_pol;
		lcm_params-dpi-de_pol;
		lcm_params-dpi-vsync_pol;
		lcm_params-dpi-hsync_pol;
		lcm_params-dpi-hsync_pulse_width;
		lcm_params-dpi-hsync_back_porch;
		lcm_params-dpi-hsync_front_porch;
		lcm_params-dpi-vsync_pulse_width;
		lcm_params-dpi-vsync_back_porch;
		lcm_params-dpi-vsync_front_porch;

		lcm_params-dpi-format;
		lcm_params-dpi-rgb_order;
		lcm_params-dpi-is_serial_output;
		lcm_params-dpi-i2x_en;
		lcm_params-dpi-i2x_edge;
		lcm_params-dpi-embsync;
		lcm_params-dpi-lvds_tx_en;
		lcm_params-dpi-bit_swap;
		lcm_params-dpi-intermediat_buffer_num;
		lcm_params-dpi-io_driving_current;
		lcm_params-dpi-lsb_io_driving_current;

		lcm_params-dsi-mode = <1>;
		lcm_params-dsi-switch_mode;
		lcm_params-dsi-DSI_WMEM_CONTI;
		lcm_params-dsi-DSI_RMEM_CONTI;
		lcm_params-dsi-VC_NUM;
		lcm_params-dsi-lane_num = <4>;
		lcm_params-dsi-data_format = <0 0 0 2>;
		/* color_order, trans_seq, padding, format */
		lcm_params-dsi-intermediat_buffer_num;
		lcm_params-dsi-ps = <2>;
		lcm_params-dsi-word_count;
		lcm_params-dsi-packet_size;

		lcm_params-dsi-vertical_sync_active = <2>;
		lcm_params-dsi-vertical_backporch = <4>;
		lcm_params-dsi-vertical_frontporch = <6>;
		lcm_params-dsi-vertical_frontporch_for_low_power;
		lcm_params-dsi-vertical_active_line = <1920>;
		lcm_params-dsi-horizontal_sync_active = <10>;
		lcm_params-dsi-horizontal_backporch = <45>;
		lcm_params-dsi-horizontal_frontporch =<96>;
		lcm_params-dsi-horizontal_blanking_pixel;
		lcm_params-dsi-horizontal_active_pixel = <1080>;
		lcm_params-dsi-horizontal_bllp;
		lcm_params-dsi-line_byte;
		lcm_params-dsi-horizontal_sync_active_byte;
		lcm_params-dsi-horizontal_backportch_byte;
		lcm_params-dsi-horizontal_frontporch_byte;
		lcm_params-dsi-rgb_byte;
		lcm_params-dsi-horizontal_sync_active_word_count;
		lcm_params-dsi-horizontal_backporch_word_count;
		lcm_params-dsi-horizontal_frontporch_word_count;

		lcm_params-dsi-HS_TRAIL;
		lcm_params-dsi-ZERO;
		lcm_params-dsi-HS_PRPR;
		lcm_params-dsi-LPX;
		lcm_params-dsi-TA_SACK;
		lcm_params-dsi-TA_GET;
		lcm_params-dsi-TA_SURE;
		lcm_params-dsi-TA_GO;
		lcm_params-dsi-CLK_TRAIL;
		lcm_params-dsi-CLK_ZERO;
		lcm_params-dsi-LPX_WAIT;
		lcm_params-dsi-CONT_DET;
		lcm_params-dsi-CLK_HS_PRPR;
		lcm_params-dsi-CLK_HS_POST;
		lcm_params-dsi-DA_HS_EXIT;
		lcm_params-dsi-CLK_HS_EXIT;

		lcm_params-dsi-pll_select;
		lcm_params-dsi-pll_div1;
		lcm_params-dsi-pll_div2;
		lcm_params-dsi-fbk_div;
		lcm_params-dsi-fbk_sel;
		lcm_params-dsi-rg_bir;
		lcm_params-dsi-rg_bic;
		lcm_params-dsi-rg_bp;
		lcm_params-dsi-pll_clock = <410>;
		lcm_params-dsi-dsi_clock;
		lcm_params-dsi-ssc_disable = <1>;
		lcm_params-dsi-ssc_range;
		lcm_params-dsi-compatibility_for_nvk;
		lcm_params-dsi-cont_clock;

		lcm_params-dsi-ufoe_enable;
		lcm_params-dsi-ufoe_params;
		/* compress_ratio, lr_mode_en, vlc_disable, vlc_config */
		lcm_params-dsi-edp_panel;

		lcm_params-dsi-customization_esd_check_enable;
		lcm_params-dsi-esd_check_enable = <1>;

		lcm_params-dsi-lcm_int_te_monitor;
		lcm_params-dsi-lcm_int_te_period;
		lcm_params-dsi-lcm_ext_te_monitor;
		lcm_params-dsi-lcm_ext_te_enable;

		lcm_params-dsi-noncont_clock;
		lcm_params-dsi-noncont_clock_period;
		lcm_params-dsi-clk_lp_per_line_enable;

		lcm_params-dsi-lcm_esd_check_table0;
		/* cmd, count, para_list[0], para_list[1] */
		lcm_params-dsi-lcm_esd_check_table1;
		lcm_params-dsi-lcm_esd_check_table2;

		lcm_params-dsi-switch_mode_enable;
		lcm_params-dsi-dual_dsi_type;
		lcm_params-dsi-lane_swap_en;
		lcm_params-dsi-lane_swap0;
		/* lane_swap[0][0~5] */
		lcm_params-dsi-lane_swap1;
		/* lane_swap[1][0~5] */
		lcm_params-dsi-vertical_vfp_lp;
		lcm_params-physical_width = <68>;
		lcm_params-physical_height = <121>;
		lcm_params-od_table_size;
		lcm_params-od_table;
	};

	lcm_ops_5{
		compatible = "mediatek,lcm_ops-r63315_tianma_tm";

		init = <LCM_FUNC_GPIO LCM_GPIO_MODE 2 LCM_GPIO_MODE_00 GPIO_LCM_PWR2_EN>,
			<LCM_FUNC_GPIO LCM_GPIO_DIR 2 LCM_GPIO_DIR_OUT GPIO_LCM_PWR2_EN>,
			<LCM_FUNC_GPIO LCM_GPIO_OUT 2 LCM_GPIO_OUT_ONE GPIO_LCM_PWR2_EN>,
			<LCM_FUNC_UTIL LCM_UTIL_MDELAY 1 10>,
			<LCM_FUNC_GPIO LCM_GPIO_MODE 2 LCM_GPIO_MODE_00 GPIO_LCM_PWR_EN>,
			<LCM_FUNC_GPIO LCM_GPIO_DIR 2 LCM_GPIO_DIR_OUT GPIO_LCM_PWR_EN>,
			<LCM_FUNC_GPIO LCM_GPIO_OUT 2 LCM_GPIO_OUT_ONE GPIO_LCM_PWR_EN>,
			<LCM_FUNC_UTIL LCM_UTIL_MDELAY 1 100>,
			<LCM_FUNC_GPIO LCM_GPIO_MODE 2 LCM_GPIO_MODE_00 GPIO_LCM_RST>,
			<LCM_FUNC_GPIO LCM_GPIO_DIR 2 LCM_GPIO_DIR_OUT GPIO_LCM_RST>,
			<LCM_FUNC_GPIO LCM_GPIO_OUT 2 LCM_GPIO_OUT_ONE GPIO_LCM_RST>,
			<LCM_FUNC_UTIL LCM_UTIL_MDELAY 1 20>,
			<LCM_FUNC_GPIO LCM_GPIO_OUT 2 LCM_GPIO_OUT_ZERO GPIO_LCM_RST>,
			<LCM_FUNC_UTIL LCM_UTIL_MDELAY 1 40>,
			<LCM_FUNC_GPIO LCM_GPIO_OUT 2 LCM_GPIO_OUT_ONE GPIO_LCM_RST>,
			<LCM_FUNC_UTIL LCM_UTIL_MDELAY 1 20>,
			<LCM_FUNC_CMD LCM_UTIL_WRITE_CMD_V1 5 1 0x00 0x23 0xB0 0x04>,
			<LCM_FUNC_CMD LCM_UTIL_WRITE_CMD_V1 5 1 0x00 0x23 0xD6 0x01>,
			<LCM_FUNC_CMD LCM_UTIL_WRITE_CMD_V1 13 3 0x02 0x29 0x07 0x00 0xB8 0x07 0x90 0x1E 0x10 0x1E 0x32 0x00>,
			<LCM_FUNC_CMD LCM_UTIL_WRITE_CMD_V1 13 3 0x02 0x29 0x07 0x00 0xB9 0x07 0x82 0x3C 0x10 0x3C 0x87 0x00>,
			<LCM_FUNC_CMD LCM_UTIL_WRITE_CMD_V1 13 3 0x02 0x29 0x07 0x00 0xBA 0x07 0x78 0x64 0x10 0x64 0xB4 0x00>,
			<LCM_FUNC_CMD LCM_UTIL_WRITE_CMD_V1 33 8 0x02 0x29 0x1A 0x00 0xD3 0x1B 0x33 0xBB 0xBB 0xB3 0x33 0x33 0x33 0x00 0x01 0x00 0xA0 0xC8 0xA0 0x0D 0x46 0x46 0x33 0x3B 0x37 0x72 0x57 0x3D 0xBF 0x33 0x00 0x00>,
			<LCM_FUNC_CMD LCM_UTIL_WRITE_CMD_V1 37 9 0x02 0x29 0x1F 0x00 0xC7 0x00 0x11 0x19 0x22 0x30 0x3E 0x48 0x58 0x3E 0x47 0x54 0x62 0x6C 0x74 0x76 0x00 0x11 0x19 0x22 0x30 0x3E 0x48 0x58 0x3E 0x47 0x54 0x62 0x6C 0x74 0x76 0x00>,
			<LCM_FUNC_CMD LCM_UTIL_WRITE_CMD_V1 25 6 0x02 0x29 0x14 0x00 0xC8 0x01 0x00 0x01 0x00 0x03 0xFC 0x00 0x00 0x01 0x00 0xFF 0xB4 0x00 0x00 0x00 0x03 0x09 0xE7 0x00>,
			<LCM_FUNC_CMD LCM_UTIL_WRITE_CMD_V1 41 10 0x02 0x29 0x21 0x00 0xCA 0x01 0x80 0xDC 0xF0 0xD0 0xF0 0xD0 0xF0 0x08 0x08 0x14 0x8A 0x0A 0x4A 0x37 0xA0 0x55 0xF8 0x0C 0x0C 0x20 0x10 0x3F 0x3F 0x19 0xD6 0x10 0x10 0x3F 0x3F 0x3F 0x3F 0x00 0x00 0x00>,
			<LCM_FUNC_CMD LCM_UTIL_WRITE_CMD_V1 5 1 0x00 0x23 0x35 0x00>,
			<LCM_FUNC_CMD LCM_UTIL_WRITE_CMD_V1 5 1 0x00 0x23 0x36 0x00>,
			<LCM_FUNC_CMD LCM_UTIL_WRITE_CMD_V1 5 1 0x00 0x23 0x51 0x00>,
			<LCM_FUNC_CMD LCM_UTIL_WRITE_CMD_V1 5 1 0x00 0x23 0x55 0x00>,
			<LCM_FUNC_CMD LCM_UTIL_WRITE_CMD_V1 5 1 0x00 0x23 0x53 0x24>,
			<LCM_FUNC_CMD LCM_UTIL_WRITE_CMD_V1 5 1 0x00 0x05 0x29 0x00>,
			<LCM_FUNC_UTIL LCM_UTIL_MDELAY 1 120>,
			<LCM_FUNC_CMD LCM_UTIL_WRITE_CMD_V1 5 1 0x00 0x05 0x11 0x00>,
			<LCM_FUNC_UTIL LCM_UTIL_MDELAY 1 20>;

		compare_id = <LCM_FUNC_GPIO LCM_GPIO_MODE 2 LCM_GPIO_MODE_00 GPIO_LCM_PWR2_EN>,
			<LCM_FUNC_GPIO LCM_GPIO_DIR 2 LCM_GPIO_DIR_OUT GPIO_LCM_PWR2_EN>,
			<LCM_FUNC_GPIO LCM_GPIO_OUT 2 LCM_GPIO_OUT_ONE GPIO_LCM_PWR2_EN>,
			<LCM_FUNC_UTIL LCM_UTIL_MDELAY 1 10>,
			<LCM_FUNC_GPIO LCM_GPIO_MODE 2 LCM_GPIO_MODE_00 GPIO_LCM_RST>,
			<LCM_FUNC_GPIO LCM_GPIO_DIR 2 LCM_GPIO_DIR_OUT GPIO_LCM_RST>,
			<LCM_FUNC_GPIO LCM_GPIO_OUT 2 LCM_GPIO_OUT_ZERO GPIO_LCM_RST>,
			<LCM_FUNC_UTIL LCM_UTIL_MDELAY 1 10>,
			<LCM_FUNC_GPIO LCM_GPIO_OUT 2 LCM_GPIO_OUT_ONE GPIO_LCM_RST>,
			<LCM_FUNC_UTIL LCM_UTIL_MDELAY 1 10>,
			<LCM_FUNC_GPIO LCM_GPIO_OUT 2 LCM_GPIO_OUT_ZERO GPIO_LCM_RST>,
			<LCM_FUNC_UTIL LCM_UTIL_MDELAY 1 10>,
			<LCM_FUNC_GPIO LCM_GPIO_OUT 2 LCM_GPIO_OUT_ONE GPIO_LCM_RST>,
			<LCM_FUNC_UTIL LCM_UTIL_MDELAY 1 10>,
			<LCM_FUNC_CMD LCM_UTIL_WRITE_CMD_V1 5 1 0x00 0x37 0x01 0x00>,
			<LCM_FUNC_UTIL LCM_UTIL_MDELAY 1 20>,
			<LCM_FUNC_CMD LCM_UTIL_READ_CMD_V2 3 0xDA 0 0x30>;

		suspend = <LCM_FUNC_CMD LCM_UTIL_WRITE_CMD_V1 5 1 0x00 0x05 0x28 0x00>,
			<LCM_FUNC_UTIL LCM_UTIL_MDELAY 1 20>,
			<LCM_FUNC_CMD LCM_UTIL_WRITE_CMD_V1 5 1 0x00 0x05 0x10 0x00>,
			<LCM_FUNC_UTIL LCM_UTIL_MDELAY 1 100>,
			<LCM_FUNC_GPIO LCM_GPIO_MODE 2 LCM_GPIO_MODE_00 GPIO_LCM_RST>,
			<LCM_FUNC_GPIO LCM_GPIO_DIR 2 LCM_GPIO_DIR_OUT GPIO_LCM_RST>,
			<LCM_FUNC_GPIO LCM_GPIO_OUT 2 LCM_GPIO_OUT_ZERO GPIO_LCM_RST>,
			<LCM_FUNC_UTIL LCM_UTIL_MDELAY 1 100>,
			<LCM_FUNC_GPIO LCM_GPIO_MODE 2 LCM_GPIO_MODE_00 GPIO_LCM_PWR_EN>,
			<LCM_FUNC_GPIO LCM_GPIO_DIR 2 LCM_GPIO_DIR_OUT GPIO_LCM_PWR_EN>,
			<LCM_FUNC_GPIO LCM_GPIO_OUT 2 LCM_GPIO_OUT_ZERO GPIO_LCM_PWR_EN>,
			<LCM_FUNC_UTIL LCM_UTIL_MDELAY 1 30>,
			<LCM_FUNC_GPIO LCM_GPIO_MODE 2 LCM_GPIO_MODE_00 GPIO_LCM_PWR2_EN>,
			<LCM_FUNC_GPIO LCM_GPIO_DIR 2 LCM_GPIO_DIR_OUT GPIO_LCM_PWR2_EN>,
			<LCM_FUNC_GPIO LCM_GPIO_OUT 2 LCM_GPIO_OUT_ZERO GPIO_LCM_PWR2_EN>,
			<LCM_FUNC_UTIL LCM_UTIL_MDELAY 1 10>;

		backlight = <LCM_FUNC_CMD LCM_UTIL_WRITE_CMD_V2 3 0x51 1 0xFF>;
	};
	/* LCM standardization end */
};

