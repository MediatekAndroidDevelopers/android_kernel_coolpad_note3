/*
 * Mediatek's LCM driver device tree
 *
 * Copyright (c) 2013 MediaTek Co., Ltd.
 *              http://www.mediatek.com
 *
 */

#include "lcm_define.h"

/ {
	/* LCM standardization */
	lcm_params {
		compatible = "mediatek,lcm_params-otm1284a_dsi_by_cpt";

		lcm_params-lcd_type = "LCD_TYPE_OTM1284A_LD_HD_720";
		lcm_params-types = <2 0 0 0>;
		/* type, ctrl, lcm_if, lcm_cmd_if */
		lcm_params-resolution = <720 1280>;
		/* width, height */
		lcm_params-io_select_mode;

		lcm_params-dbi-port;
		lcm_params-dbi-clock_freq;
		lcm_params-dbi-data_width;
		lcm_params-dbi-data_format;
		/* color_order, trans_seq, padding, format, width */
		lcm_params-dbi-cpu_write_bits;
		lcm_params-dbi-io_driving_current;
		lcm_params-dbi-msb_io_driving_current;
		lcm_params-dbi-ctrl_io_driving_current;

		lcm_params-dbi-te_mode;
		lcm_params-dbi-te_edge_polarity;
		lcm_params-dbi-te_hs_delay_cnt;
		lcm_params-dbi-te_vs_width_cnt;
		lcm_params-dbi-te_vs_width_cnt_div;

		lcm_params-dbi-serial-params0;
		/* cs_polarity, clk_polarity, clk_phase, is_non_dbi_mode, clock_base, clock_div */
		lcm_params-dbi-serial-params1;
		/* css, csh, rd_1st, rd_2nd, wr_1st, wr_2nd */
		lcm_params-dbi-serial-params2;
		/* sif_1st_pol, sif_sck_def, sif_3wire, sif_sdi sif_div2, sif_hw_cs */
		lcm_params-dbi-parallel-params0;
		/* write_setup, write_hold, write_wait, read_setup */
		lcm_params-dbi-parallel-params1;
		/* read_hold, read_latency, wait_period, cs_high_width */

		lcm_params-dpi-mipi_pll_clk_ref;
		lcm_params-dpi-mipi_pll_clk_div1;
		lcm_params-dpi-mipi_pll_clk_div2;
		lcm_params-dpi-mipi_pll_clk_fbk_div;

		lcm_params-dpi-dpi_clk_div;
		lcm_params-dpi-dpi_clk_duty;
		lcm_params-dpi-PLL_CLOCK;
		lcm_params-dpi-dpi_clock;
		lcm_params-dpi-ssc_disable;
		lcm_params-dpi-ssc_range;

		lcm_params-dpi-width;
		lcm_params-dpi-height;
		lcm_params-dpi-bg_width;
		lcm_params-dpi-bg_height;

		lcm_params-dpi-clk_pol;
		lcm_params-dpi-de_pol;
		lcm_params-dpi-vsync_pol;
		lcm_params-dpi-hsync_pol;
		lcm_params-dpi-hsync_pulse_width;
		lcm_params-dpi-hsync_back_porch;
		lcm_params-dpi-hsync_front_porch;
		lcm_params-dpi-vsync_pulse_width;
		lcm_params-dpi-vsync_back_porch;
		lcm_params-dpi-vsync_front_porch;

		lcm_params-dpi-format;
		lcm_params-dpi-rgb_order;
		lcm_params-dpi-is_serial_output;
		lcm_params-dpi-i2x_en;
		lcm_params-dpi-i2x_edge;
		lcm_params-dpi-embsync;
		lcm_params-dpi-lvds_tx_en;
		lcm_params-dpi-bit_swap;
		lcm_params-dpi-intermediat_buffer_num;
		lcm_params-dpi-io_driving_current;
		lcm_params-dpi-lsb_io_driving_current;

		lcm_params-dsi-mode = <1>;
		lcm_params-dsi-switch_mode;
		lcm_params-dsi-DSI_WMEM_CONTI;
		lcm_params-dsi-DSI_RMEM_CONTI;
		lcm_params-dsi-VC_NUM;
		lcm_params-dsi-lane_num = <4>;
		lcm_params-dsi-data_format = <0 0 0 2>;
		/* color_order, trans_seq, padding, format */
		lcm_params-dsi-intermediat_buffer_num;
		lcm_params-dsi-ps = <2>;
		lcm_params-dsi-word_count;
		lcm_params-dsi-packet_size;

		lcm_params-dsi-vertical_sync_active = <6>;
		lcm_params-dsi-vertical_backporch = <14>;
		lcm_params-dsi-vertical_frontporch = <16>;
		lcm_params-dsi-vertical_frontporch_for_low_power;
		lcm_params-dsi-vertical_active_line = <1280>;
		lcm_params-dsi-horizontal_sync_active = <10>;
		lcm_params-dsi-horizontal_backporch = <100>;
		lcm_params-dsi-horizontal_frontporch =<86>;
		lcm_params-dsi-horizontal_blanking_pixel;
		lcm_params-dsi-horizontal_active_pixel = <720>;
		lcm_params-dsi-horizontal_bllp;
		lcm_params-dsi-line_byte;
		lcm_params-dsi-horizontal_sync_active_byte;
		lcm_params-dsi-horizontal_backportch_byte;
		lcm_params-dsi-horizontal_frontporch_byte;
		lcm_params-dsi-rgb_byte;
		lcm_params-dsi-horizontal_sync_active_word_count;
		lcm_params-dsi-horizontal_backporch_word_count;
		lcm_params-dsi-horizontal_frontporch_word_count;

		lcm_params-dsi-HS_TRAIL;
		lcm_params-dsi-ZERO;
		lcm_params-dsi-HS_PRPR;
		lcm_params-dsi-LPX;
		lcm_params-dsi-TA_SACK;
		lcm_params-dsi-TA_GET;
		lcm_params-dsi-TA_SURE;
		lcm_params-dsi-TA_GO;
		lcm_params-dsi-CLK_TRAIL;
		lcm_params-dsi-CLK_ZERO;
		lcm_params-dsi-LPX_WAIT;
		lcm_params-dsi-CONT_DET;
		lcm_params-dsi-CLK_HS_PRPR;
		lcm_params-dsi-CLK_HS_POST;
		lcm_params-dsi-DA_HS_EXIT;
		lcm_params-dsi-CLK_HS_EXIT;

		lcm_params-dsi-pll_select;
		lcm_params-dsi-pll_div1;
		lcm_params-dsi-pll_div2;
		lcm_params-dsi-fbk_div;
		lcm_params-dsi-fbk_sel;
		lcm_params-dsi-rg_bir;
		lcm_params-dsi-rg_bic;
		lcm_params-dsi-rg_bp;
		lcm_params-dsi-pll_clock = <220>;
		lcm_params-dsi-dsi_clock;
		lcm_params-dsi-ssc_disable = <1>;
		lcm_params-dsi-ssc_range;
		lcm_params-dsi-compatibility_for_nvk;
		lcm_params-dsi-cont_clock;

		lcm_params-dsi-ufoe_enable;
		lcm_params-dsi-ufoe_params;
		/* compress_ratio, lr_mode_en, vlc_disable, vlc_config */
		lcm_params-dsi-edp_panel;

		lcm_params-dsi-customization_esd_check_enable = <0>;
		lcm_params-dsi-esd_check_enable = <1>;

		lcm_params-dsi-lcm_int_te_monitor;
		lcm_params-dsi-lcm_int_te_period;
		lcm_params-dsi-lcm_ext_te_monitor;
		lcm_params-dsi-lcm_ext_te_enable;

		lcm_params-dsi-noncont_clock = <1>;
		lcm_params-dsi-noncont_clock_period = <2>;
		lcm_params-dsi-clk_lp_per_line_enable;

		lcm_params-dsi-lcm_esd_check_table0;
		/* cmd, count, para_list[0], para_list[1] */
		lcm_params-dsi-lcm_esd_check_table1;
		lcm_params-dsi-lcm_esd_check_table2;

		lcm_params-dsi-switch_mode_enable;
		lcm_params-dsi-dual_dsi_type;
		lcm_params-dsi-lane_swap_en;
		lcm_params-dsi-lane_swap0;
		/* lane_swap[0][0~5] */
		lcm_params-dsi-lane_swap1;
		/* lane_swap[1][0~5] */
		lcm_params-dsi-vertical_vfp_lp;
		lcm_params-physical_width = <68>;
		lcm_params-physical_height = <121>;
		lcm_params-od_table_size;
		lcm_params-od_table;
	};

	lcm_ops {
		compatible = "mediatek,lcm_ops-otm1284a_dsi_by_cpt";

		init = <LCM_FUNC_GPIO LCM_GPIO_MODE 2 LCM_GPIO_MODE_00 GPIO_LCM_PWR2_EN>,
			<LCM_FUNC_GPIO LCM_GPIO_DIR 2 LCM_GPIO_DIR_OUT GPIO_LCM_PWR2_EN>,
			<LCM_FUNC_GPIO LCM_GPIO_OUT 2 LCM_GPIO_OUT_ONE GPIO_LCM_PWR2_EN>,
			<LCM_FUNC_UTIL LCM_UTIL_MDELAY 1 10>,
			<LCM_FUNC_GPIO LCM_GPIO_MODE 2 LCM_GPIO_MODE_00 GPIO_LCM_RST>,
			<LCM_FUNC_GPIO LCM_GPIO_DIR 2 LCM_GPIO_DIR_OUT GPIO_LCM_RST>,
			<LCM_FUNC_GPIO LCM_GPIO_OUT 2 LCM_GPIO_OUT_ONE GPIO_LCM_RST>,
			<LCM_FUNC_UTIL LCM_UTIL_MDELAY 1 10>,
			<LCM_FUNC_GPIO LCM_GPIO_OUT 2 LCM_GPIO_OUT_ZERO GPIO_LCM_RST>,
			<LCM_FUNC_UTIL LCM_UTIL_MDELAY 1 10>,
			<LCM_FUNC_GPIO LCM_GPIO_OUT 2 LCM_GPIO_OUT_ONE GPIO_LCM_RST>,
			<LCM_FUNC_UTIL LCM_UTIL_MDELAY 1 10>,
			<LCM_FUNC_GPIO LCM_GPIO_MODE 2 LCM_GPIO_MODE_00 GPIO_LCM_PWR_EN>,
			<LCM_FUNC_GPIO LCM_GPIO_DIR 2 LCM_GPIO_DIR_OUT GPIO_LCM_PWR_EN>,
			<LCM_FUNC_GPIO LCM_GPIO_OUT 2 LCM_GPIO_OUT_ONE GPIO_LCM_PWR_EN>,
			<LCM_FUNC_UTIL LCM_UTIL_MDELAY 1 10>,
			<LCM_FUNC_GPIO LCM_GPIO_OUT 2 LCM_GPIO_OUT_ZERO GPIO_LCM_RST>,
			<LCM_FUNC_UTIL LCM_UTIL_MDELAY 1 10>,
			<LCM_FUNC_GPIO LCM_GPIO_OUT 2 LCM_GPIO_OUT_ONE GPIO_LCM_RST>,
			<LCM_FUNC_UTIL LCM_UTIL_MDELAY 1 20>,
			<LCM_FUNC_CMD LCM_UTIL_WRITE_CMD_V1 5 1 0x00 0x23 0x00 0x00>,
			<LCM_FUNC_CMD LCM_UTIL_WRITE_CMD_V1 9 2 0x02 0x29 0x04 0x00 0xFF 0x12 0x84 0x01>,
			<LCM_FUNC_CMD LCM_UTIL_WRITE_CMD_V1 5 1 0x00 0x23 0x00 0x80>,
			<LCM_FUNC_CMD LCM_UTIL_WRITE_CMD_V1 9 2 0x02 0x29 0x03 0x00 0xFF 0x12 0x84 0x00>,
			<LCM_FUNC_CMD LCM_UTIL_WRITE_CMD_V1 5 1 0x00 0x23 0x00 0x92>,
			<LCM_FUNC_CMD LCM_UTIL_WRITE_CMD_V1 9 2 0x02 0x29 0x03 0x00 0xFF 0x30 0x02 0x00>,
			<LCM_FUNC_CMD LCM_UTIL_WRITE_CMD_V1 5 1 0x00 0x23 0x00 0x80>,
			<LCM_FUNC_CMD LCM_UTIL_WRITE_CMD_V1 17 4 0x02 0x29 0x0a 0x00 0xC0 0x00 0x64 0x00 0x10 0x10 0x00 0x64 0x10 0x10 0x00 0x00>,
			<LCM_FUNC_CMD LCM_UTIL_WRITE_CMD_V1 5 1 0x00 0x23 0x00 0x90>,
			<LCM_FUNC_CMD LCM_UTIL_WRITE_CMD_V1 13 3 0x02 0x29 0x07 0x00 0xC0 0x00 0x5C 0x00 0x01 0x00 0x04 0x00>,
			<LCM_FUNC_CMD LCM_UTIL_WRITE_CMD_V1 5 1 0x00 0x23 0x00 0xB3>,
			<LCM_FUNC_CMD LCM_UTIL_WRITE_CMD_V1 9 2 0x02 0x29 0x03 0x00 0xC0 0x00 0x55 0x00>,
			<LCM_FUNC_CMD LCM_UTIL_WRITE_CMD_V1 5 1 0x00 0x23 0x00 0x81>,
			<LCM_FUNC_CMD LCM_UTIL_WRITE_CMD_V1 5 1 0x00 0x23 0xC1 0x55>,
			<LCM_FUNC_CMD LCM_UTIL_WRITE_CMD_V1 5 1 0x00 0x23 0x00 0xA0>,
			<LCM_FUNC_CMD LCM_UTIL_WRITE_CMD_V1 21 5 0x02 0x29 0x0f 0x00 0xC4 0x05 0x10 0x06 0x02 0x05 0x15 0x10 0x05 0x10 0x07 0x02 0x05 0x15 0x10 0x00>,
			<LCM_FUNC_CMD LCM_UTIL_WRITE_CMD_V1 5 1 0x00 0x23 0x00 0xB0>,
			<LCM_FUNC_CMD LCM_UTIL_WRITE_CMD_V1 9 2 0x02 0x29 0x03 0x00 0xC4 0x00 0x00 0x00>,
			<LCM_FUNC_CMD LCM_UTIL_WRITE_CMD_V1 5 1 0x00 0x23 0x00 0x91>,
			<LCM_FUNC_CMD LCM_UTIL_WRITE_CMD_V1 9 2 0x02 0x29 0x03 0x00 0xC5 0x46 0x42 0x00>,
			<LCM_FUNC_CMD LCM_UTIL_WRITE_CMD_V1 5 1 0x00 0x23 0x00 0x00>,
			<LCM_FUNC_CMD LCM_UTIL_WRITE_CMD_V1 9 2 0x02 0x29 0x03 0x00 0xD8 0xBC 0xBC 0x00>,
			<LCM_FUNC_CMD LCM_UTIL_WRITE_CMD_V1 5 1 0x00 0x23 0x00 0xB3>,
			<LCM_FUNC_CMD LCM_UTIL_WRITE_CMD_V1 5 1 0x00 0x23 0xC5 0x44>,
			<LCM_FUNC_CMD LCM_UTIL_WRITE_CMD_V1 5 1 0x00 0x23 0x00 0xBB>,
			<LCM_FUNC_CMD LCM_UTIL_WRITE_CMD_V1 5 1 0x00 0x23 0xC5 0x8A>,
			<LCM_FUNC_CMD LCM_UTIL_WRITE_CMD_V1 5 1 0x00 0x23 0x00 0x82>,
			<LCM_FUNC_CMD LCM_UTIL_WRITE_CMD_V1 5 1 0x00 0x23 0xC4 0x0A>,
			<LCM_FUNC_CMD LCM_UTIL_WRITE_CMD_V1 5 1 0x00 0x23 0x00 0xC6>,
			<LCM_FUNC_CMD LCM_UTIL_WRITE_CMD_V1 5 1 0x00 0x23 0xB0 0x03>,
			<LCM_FUNC_CMD LCM_UTIL_WRITE_CMD_V1 5 1 0x00 0x23 0x00 0xC2>,
			<LCM_FUNC_CMD LCM_UTIL_WRITE_CMD_V1 9 2 0x02 0x29 0x03 0x00 0xF5 0x40 0x85 0x00>,
			<LCM_FUNC_CMD LCM_UTIL_WRITE_CMD_V1 5 1 0x00 0x23 0x00 0x87>,
			<LCM_FUNC_CMD LCM_UTIL_WRITE_CMD_V1 5 1 0x00 0x23 0xC4 0x18>,
			<LCM_FUNC_CMD LCM_UTIL_WRITE_CMD_V1 5 1 0x00 0x23 0x00 0x00>,
			<LCM_FUNC_CMD LCM_UTIL_WRITE_CMD_V1 5 1 0x00 0x23 0xD0 0x40>,
			<LCM_FUNC_CMD LCM_UTIL_WRITE_CMD_V1 5 1 0x00 0x23 0x00 0x00>,
			<LCM_FUNC_CMD LCM_UTIL_WRITE_CMD_V1 9 2 0x02 0x29 0x03 0x00 0xD1 0x00 0x00 0x00>,
			<LCM_FUNC_CMD LCM_UTIL_WRITE_CMD_V1 5 1 0x00 0x23 0x00 0x80>,
			<LCM_FUNC_CMD LCM_UTIL_WRITE_CMD_V1 17 4 0x02 0x29 0x0c 0x00 0xCB 0x00 0x00 0x00 0x00 0x00 0x00 0x00 0x00 0x00 0x00 0x00>,
			<LCM_FUNC_CMD LCM_UTIL_WRITE_CMD_V1 5 1 0x00 0x23 0x00 0x90>,
			<LCM_FUNC_CMD LCM_UTIL_WRITE_CMD_V1 21 5 0x02 0x29 0x10 0x00 0xCB 0x00 0x00 0x00 0x00 0x00 0x00 0x00 0x00 0x00 0x00 0x00 0x00 0x00 0x00 0x00>,
			<LCM_FUNC_CMD LCM_UTIL_WRITE_CMD_V1 5 1 0x00 0x23 0x00 0xA0>,
			<LCM_FUNC_CMD LCM_UTIL_WRITE_CMD_V1 21 5 0x02 0x29 0x10 0x00 0xCB 0x00 0x00 0x00 0x00 0x00 0x00 0x00 0x00 0x00 0x00 0x00 0x00 0x00 0x00 0x00>,
			<LCM_FUNC_CMD LCM_UTIL_WRITE_CMD_V1 5 1 0x00 0x23 0x00 0xB0>,
			<LCM_FUNC_CMD LCM_UTIL_WRITE_CMD_V1 21 5 0x02 0x29 0x10 0x00 0xCB 0x00 0x00 0x00 0x00 0x00 0x00 0x00 0x00 0x00 0x00 0x00 0x00 0x00 0x00 0x00>,
			<LCM_FUNC_CMD LCM_UTIL_WRITE_CMD_V1 5 1 0x00 0x23 0x00 0xC0>,
			<LCM_FUNC_CMD LCM_UTIL_WRITE_CMD_V1 21 5 0x02 0x29 0x10 0x00 0xCB 0x05 0x05 0x05 0x05 0x05 0x00 0x00 0x00 0x00 0x00 0x00 0x00 0x00 0x00 0x00>,
			<LCM_FUNC_CMD LCM_UTIL_WRITE_CMD_V1 5 1 0x00 0x23 0x00 0xD0>,
			<LCM_FUNC_CMD LCM_UTIL_WRITE_CMD_V1 21 5 0x02 0x29 0x10 0x00 0xCB 0xFF 0xFF 0xFF 0x00 0x05 0x05 0x05 0x05 0x05 0x05 0x05 0x05 0x00 0x00 0x00>,
			<LCM_FUNC_CMD LCM_UTIL_WRITE_CMD_V1 5 1 0x00 0x23 0x00 0xE0>,
			<LCM_FUNC_CMD LCM_UTIL_WRITE_CMD_V1 21 5 0x02 0x29 0x0f 0x00 0xCB 0x00 0x00 0x00 0x00 0x00 0x00 0x00 0xFF 0xFF 0xFF 0x00 0x05 0x05 0x05 0x00>,
			<LCM_FUNC_CMD LCM_UTIL_WRITE_CMD_V1 5 1 0x00 0x23 0x00 0xF0>,
			<LCM_FUNC_CMD LCM_UTIL_WRITE_CMD_V1 17 4 0x02 0x29 0x0c 0x00 0xCB 0xFF 0xFF 0xFF 0xFF 0xFF 0xFF 0xFF 0xFF 0xFF 0xFF 0xFF>,
			<LCM_FUNC_CMD LCM_UTIL_WRITE_CMD_V1 5 1 0x00 0x23 0x00 0x80>,
			<LCM_FUNC_CMD LCM_UTIL_WRITE_CMD_V1 21 5 0x02 0x29 0x10 0x00 0xCC 0x02 0x0A 0x0C 0x0E 0x10 0x00 0x00 0x00 0x00 0x00 0x00 0x00 0x00 0x00 0x00>,
			<LCM_FUNC_CMD LCM_UTIL_WRITE_CMD_V1 5 1 0x00 0x23 0x00 0x90>,
			<LCM_FUNC_CMD LCM_UTIL_WRITE_CMD_V1 21 5 0x02 0x29 0x10 0x00 0xCC 0x00 0x00 0x00 0x00 0x2E 0x2D 0x06 0x01 0x09 0x0B 0x0D 0x0F 0x00 0x00 0x00>,
			<LCM_FUNC_CMD LCM_UTIL_WRITE_CMD_V1 5 1 0x00 0x23 0x00 0xA0>,
			<LCM_FUNC_CMD LCM_UTIL_WRITE_CMD_V1 21 5 0x02 0x29 0x0f 0x00 0xCC 0x00 0x00 0x00 0x00 0x00 0x00 0x00 0x00 0x00 0x00 0x00 0x2E 0x2D 0x05 0x00>,
			<LCM_FUNC_CMD LCM_UTIL_WRITE_CMD_V1 5 1 0x00 0x23 0x00 0xB0>,
			<LCM_FUNC_CMD LCM_UTIL_WRITE_CMD_V1 21 5 0x02 0x29 0x10 0x00 0xCC 0x05 0x0F 0x0D 0x0B 0x09 0x00 0x00 0x00 0x00 0x00 0x00 0x00 0x00 0x00 0x00>,
			<LCM_FUNC_CMD LCM_UTIL_WRITE_CMD_V1 5 1 0x00 0x23 0x00 0xC0>,
			<LCM_FUNC_CMD LCM_UTIL_WRITE_CMD_V1 21 5 0x02 0x29 0x10 0x00 0xCC 0x00 0x00 0x00 0x00 0x2D 0x2E 0x01 0x06 0x10 0x0E 0x0C 0x0A 0x00 0x00 0x00>,
			<LCM_FUNC_CMD LCM_UTIL_WRITE_CMD_V1 5 1 0x00 0x23 0x00 0xD0>,
			<LCM_FUNC_CMD LCM_UTIL_WRITE_CMD_V1 21 5 0x02 0x29 0x0f 0x00 0xCC 0x00 0x00 0x00 0x00 0x00 0x00 0x00 0x00 0x00 0x00 0x00 0x2D 0x2E 0x02 0x00>,
			<LCM_FUNC_CMD LCM_UTIL_WRITE_CMD_V1 5 1 0x00 0x23 0x00 0x80>,
			<LCM_FUNC_CMD LCM_UTIL_WRITE_CMD_V1 21 5 0x02 0x29 0x0d 0x00 0xCE 0x87 0x03 0x10 0x86 0x03 0x10 0x00 0x00 0x00 0x00 0x00 0x00 0x00 0x00 0x00>,
			<LCM_FUNC_CMD LCM_UTIL_WRITE_CMD_V1 5 1 0x00 0x23 0x00 0x90>,
			<LCM_FUNC_CMD LCM_UTIL_WRITE_CMD_V1 21 5 0x02 0x29 0x0f 0x00 0xCE 0x35 0x01 0x10 0x35 0x02 0x10 0x00 0x00 0x00 0x00 0x00 0x00 0x00 0x00 0x00>,
			<LCM_FUNC_CMD LCM_UTIL_WRITE_CMD_V1 5 1 0x00 0x23 0x00 0xA0>,
			<LCM_FUNC_CMD LCM_UTIL_WRITE_CMD_V1 21 5 0x02 0x29 0x0f 0x00 0xCE 0x38 0x03 0x04 0xF8 0x00 0x10 0x00 0x38 0x02 0x04 0xF9 0x00 0x10 0x00 0x00>,
			<LCM_FUNC_CMD LCM_UTIL_WRITE_CMD_V1 5 1 0x00 0x23 0x00 0xB0>,
			<LCM_FUNC_CMD LCM_UTIL_WRITE_CMD_V1 21 5 0x02 0x29 0x0f 0x00 0xCE 0x38 0x01 0x04 0xFA 0x00 0x10 0x00 0x38 0x00 0x04 0xFB 0x00 0x10 0x00 0x00>,
			<LCM_FUNC_CMD LCM_UTIL_WRITE_CMD_V1 5 1 0x00 0x23 0x00 0xC0>,
			<LCM_FUNC_CMD LCM_UTIL_WRITE_CMD_V1 21 5 0x02 0x29 0x0f 0x00 0xCE 0x30 0x00 0x04 0xFC 0x00 0x10 0x00 0x30 0x01 0x04 0xFD 0x00 0x10 0x00 0x00>,
			<LCM_FUNC_CMD LCM_UTIL_WRITE_CMD_V1 5 1 0x00 0x23 0x00 0xD0>,
			<LCM_FUNC_CMD LCM_UTIL_WRITE_CMD_V1 21 5 0x02 0x29 0x0f 0x00 0xCE 0x30 0x02 0x04 0xFE 0x00 0x10 0x00 0x30 0x03 0x04 0xFF 0x00 0x10 0x00 0x00>,
			<LCM_FUNC_CMD LCM_UTIL_WRITE_CMD_V1 5 1 0x00 0x23 0x00 0x80>,
			<LCM_FUNC_CMD LCM_UTIL_WRITE_CMD_V1 21 5 0x02 0x29 0x0f 0x00 0xCF 0x00 0x00 0x00 0x00 0x00 0x00 0x00 0x00 0x00 0x00 0x00 0x00 0x00 0x00 0x00>,
			<LCM_FUNC_CMD LCM_UTIL_WRITE_CMD_V1 5 1 0x00 0x23 0x00 0x90>,
			<LCM_FUNC_CMD LCM_UTIL_WRITE_CMD_V1 21 5 0x02 0x29 0x0f 0x00 0xCF 0x00 0x00 0x00 0x00 0x00 0x00 0x00 0x00 0x00 0x00 0x00 0x00 0x00 0x00 0x00>,
			<LCM_FUNC_CMD LCM_UTIL_WRITE_CMD_V1 5 1 0x00 0x23 0x00 0xA0>,
			<LCM_FUNC_CMD LCM_UTIL_WRITE_CMD_V1 21 5 0x02 0x29 0x0f 0x00 0xCF 0x00 0x00 0x00 0x00 0x00 0x00 0x00 0x00 0x00 0x00 0x00 0x00 0x00 0x00 0x00>,
			<LCM_FUNC_CMD LCM_UTIL_WRITE_CMD_V1 5 1 0x00 0x23 0x00 0xB0>,
			<LCM_FUNC_CMD LCM_UTIL_WRITE_CMD_V1 21 5 0x02 0x29 0x0f 0x00 0xCF 0x00 0x00 0x00 0x00 0x00 0x00 0x00 0x00 0x00 0x00 0x00 0x00 0x00 0x00 0x00>,
			<LCM_FUNC_CMD LCM_UTIL_WRITE_CMD_V1 5 1 0x00 0x23 0x00 0xC0>,
			<LCM_FUNC_CMD LCM_UTIL_WRITE_CMD_V1 17 4 0x02 0x29 0x0c 0x00 0xCF 0x01 0x01 0x20 0x20 0x00 0x00 0x01 0x81 0x00 0x03 0x08>,
			<LCM_FUNC_CMD LCM_UTIL_WRITE_CMD_V1 5 1 0x00 0x23 0x00 0xB5>,
			<LCM_FUNC_CMD LCM_UTIL_WRITE_CMD_V1 13 3 0x02 0x29 0x07 0x00 0xC5 0x3F 0xFF 0xFF 0x3F 0xFF 0xFF 0x00>,
			<LCM_FUNC_CMD LCM_UTIL_WRITE_CMD_V1 5 1 0x00 0x23 0x00 0x90>,
			<LCM_FUNC_CMD LCM_UTIL_WRITE_CMD_V1 13 3 0x02 0x29 0x05 0x00 0xF5 0x02 0x11 0x02 0x15 0x00 0x00 0x00>,
			<LCM_FUNC_CMD LCM_UTIL_WRITE_CMD_V1 5 1 0x00 0x23 0x00 0x90>,
			<LCM_FUNC_CMD LCM_UTIL_WRITE_CMD_V1 5 1 0x00 0x23 0xC5 0x50>,
			<LCM_FUNC_CMD LCM_UTIL_WRITE_CMD_V1 5 1 0x00 0x23 0x00 0x94>,
			<LCM_FUNC_CMD LCM_UTIL_WRITE_CMD_V1 5 1 0x00 0x23 0xC5 0x66>,
			<LCM_FUNC_CMD LCM_UTIL_WRITE_CMD_V1 5 1 0x00 0x23 0x00 0xB2>,
			<LCM_FUNC_CMD LCM_UTIL_WRITE_CMD_V1 17 4 0x02 0x29 0x09 0x00 0xF5 0x00 0x00 0x00 0x00 0x00 0x00 0x00 0x00 0x00 0x00 0x00>,
			<LCM_FUNC_CMD LCM_UTIL_WRITE_CMD_V1 5 1 0x00 0x23 0x00 0x94>,
			<LCM_FUNC_CMD LCM_UTIL_WRITE_CMD_V1 9 2 0x02 0x29 0x03 0x00 0xF5 0x00 0x00 0x00>,
			<LCM_FUNC_CMD LCM_UTIL_WRITE_CMD_V1 5 1 0x00 0x23 0x00 0xD2>,
			<LCM_FUNC_CMD LCM_UTIL_WRITE_CMD_V1 9 2 0x02 0x29 0x03 0x00 0xF5 0x06 0x15 0x00>,
			<LCM_FUNC_CMD LCM_UTIL_WRITE_CMD_V1 5 1 0x00 0x23 0x00 0xB4>,
			<LCM_FUNC_CMD LCM_UTIL_WRITE_CMD_V1 5 1 0x00 0x23 0xC5 0xCC>,
			<LCM_FUNC_CMD LCM_UTIL_WRITE_CMD_V1 5 1 0x00 0x23 0x00 0x00>,
			<LCM_FUNC_CMD LCM_UTIL_WRITE_CMD_V1 29 7 0x02 0x29 0x15 0x00 0xE1 0x00 0x14 0x22 0x2e 0x40 0x4e 0x51 0x81 0x75 0x92 0x6f 0x58 0x6a 0x48 0x47 0x3c 0x2e 0x1f 0x0e 0x00 0x00 0x00 0x00>,
			<LCM_FUNC_CMD LCM_UTIL_WRITE_CMD_V1 5 1 0x00 0x23 0x00 0x00>,
			<LCM_FUNC_CMD LCM_UTIL_WRITE_CMD_V1 29 7 0x02 0x29 0x15 0x00 0xE2 0x00 0x14 0x22 0x2e 0x40 0x4e 0x51 0x81 0x75 0x92 0x70 0x59 0x6B 0x47 0x47 0x3c 0x2e 0x1f 0x0e 0x00 0x00 0x00 0x00>,
			<LCM_FUNC_CMD LCM_UTIL_WRITE_CMD_V1 5 1 0x00 0x23 0x00 0x00>,
			<LCM_FUNC_CMD LCM_UTIL_WRITE_CMD_V1 41 10 0x02 0x29 0x22 0x00 0xEC 0x40 0x34 0x44 0x44 0x43 0x44 0x34 0x44 0x44 0x43 0x44 0x34 0x44 0x44 0x43 0x44 0x34 0x44 0x34 0x44 0x44 0x43 0x44 0x34 0x44 0x44 0x43 0x44 0x34 0x44 0x44 0x43 0x04 0x00 0x00>,
			<LCM_FUNC_CMD LCM_UTIL_WRITE_CMD_V1 5 1 0x00 0x23 0x00 0x00>,
			<LCM_FUNC_CMD LCM_UTIL_WRITE_CMD_V1 41 10 0x02 0x29 0x22 0x00 0xED 0x40 0x44 0x43 0x44 0x44 0x34 0x44 0x44 0x44 0x43 0x44 0x44 0x34 0x44 0x44 0x44 0x34 0x44 0x44 0x44 0x43 0x44 0x44 0x34 0x44 0x44 0x44 0x43 0x44 0x44 0x34 0x44 0x04 0x00 0x00>,
			<LCM_FUNC_CMD LCM_UTIL_WRITE_CMD_V1 5 1 0x00 0x23 0x00 0x00>,
			<LCM_FUNC_CMD LCM_UTIL_WRITE_CMD_V1 41 10 0x02 0x29 0x22 0x00 0xEE 0x40 0x43 0x43 0x43 0x34 0x34 0x44 0x43 0x43 0x43 0x34 0x34 0x34 0x44 0x43 0x43 0x34 0x34 0x34 0x44 0x43 0x43 0x43 0x34 0x34 0x34 0x44 0x43 0x43 0x34 0x34 0x34 0x04 0x00 0x00>,
			<LCM_FUNC_CMD LCM_UTIL_WRITE_CMD_V1 5 1 0x00 0x23 0x00 0xA0>,
			<LCM_FUNC_CMD LCM_UTIL_WRITE_CMD_V1 21 5 0x02 0x29 0x0d 0x00 0xD6 0x01 0x0d 0x01 0x0d 0x01 0xa6 0x01 0xa6 0x01 0xa6 0x01 0xa6 0x00 0x00 0x00>,
			<LCM_FUNC_CMD LCM_UTIL_WRITE_CMD_V1 5 1 0x00 0x23 0x00 0xB0>,
			<LCM_FUNC_CMD LCM_UTIL_WRITE_CMD_V1 21 5 0x02 0x29 0x0d 0x00 0xD6 0x01 0xa6 0x01 0xa6 0x01 0xa6 0x01 0xa6 0x01 0xa6 0x01 0xa6 0x00 0x00 0x00>,
			<LCM_FUNC_CMD LCM_UTIL_WRITE_CMD_V1 5 1 0x00 0x23 0x00 0xC0>,
			<LCM_FUNC_CMD LCM_UTIL_WRITE_CMD_V1 21 5 0x02 0x29 0x0d 0x00 0xD6 0x55 0x11 0x09 0x6f 0x11 0x6f 0x6f 0x11 0x6f 0x6f 0x11 0x6f 0x00 0x00 0x00>,
			<LCM_FUNC_CMD LCM_UTIL_WRITE_CMD_V1 5 1 0x00 0x23 0x00 0xD0>,
			<LCM_FUNC_CMD LCM_UTIL_WRITE_CMD_V1 13 3 0x02 0x29 0x07 0x00 0xD6 0x6f 0x11 0x6f 0x6f 0x11 0x6f 0x00>,
			<LCM_FUNC_CMD LCM_UTIL_WRITE_CMD_V1 5 1 0x00 0x23 0x00 0xE0>,
			<LCM_FUNC_CMD LCM_UTIL_WRITE_CMD_V1 21 5 0x02 0x29 0x0d 0x00 0xD6 0x2b 0x11 0x37 0x37 0x11 0x37 0x37 0x11 0x37 0x37 0x11 0x37 0x00 0x00 0x00>,
			<LCM_FUNC_CMD LCM_UTIL_WRITE_CMD_V1 5 1 0x00 0x23 0x00 0xF0>,
			<LCM_FUNC_CMD LCM_UTIL_WRITE_CMD_V1 13 3 0x02 0x29 0x07 0x00 0xD6 0x37 0x11 0x37 0x37 0x11 0x37 0x00>,
			<LCM_FUNC_CMD LCM_UTIL_WRITE_CMD_V1 5 1 0x00 0x23 0x00 0x80>,
			<LCM_FUNC_CMD LCM_UTIL_WRITE_CMD_V1 37 9 0x02 0x29 0x1d 0x00 0xCA 0x01 0x8e 0x95 0x9d 0xa4 0xab 0xb2 0xba 0xc1 0xc8 0xcf 0xd7 0xde 0xe5 0xec 0xf4 0xe8 0xff 0x87 0xff 0x87 0xff 0x05 0x03 0x05 0x03 0x05 0x03 0x00 0x00 0x00>,
			<LCM_FUNC_CMD LCM_UTIL_WRITE_CMD_V1 5 1 0x00 0x23 0x00 0x00>,
			<LCM_FUNC_CMD LCM_UTIL_WRITE_CMD_V1 5 1 0x00 0x23 0xC6 0x10>,
			<LCM_FUNC_CMD LCM_UTIL_WRITE_CMD_V1 25 6 0x02 0x29 0x13 0x00 0xc7 0x90 0xA9 0xAA 0xAA 0xAA 0xAA 0xAA 0xAA 0x99 0x88 0x88 0x88 0x77 0x66 0x55 0x55 0x55 0x55 0x00>,
			<LCM_FUNC_CMD LCM_UTIL_WRITE_CMD_V1 5 1 0x00 0x23 0x00 0x00>,
			<LCM_FUNC_CMD LCM_UTIL_WRITE_CMD_V1 5 1 0x00 0x23 0xC6 0x11>,
			<LCM_FUNC_CMD LCM_UTIL_WRITE_CMD_V1 25 6 0x02 0x29 0x13 0x00 0xc7 0x90 0x99 0xAA 0xAA 0xAA 0xAA 0xAA 0x9A 0x99 0x88 0x88 0x88 0x77 0x66 0x66 0x55 0x55 0x55 0x00>,
			<LCM_FUNC_CMD LCM_UTIL_WRITE_CMD_V1 5 1 0x00 0x23 0x00 0x00>,
			<LCM_FUNC_CMD LCM_UTIL_WRITE_CMD_V1 5 1 0x00 0x23 0xC6 0x12>,
			<LCM_FUNC_CMD LCM_UTIL_WRITE_CMD_V1 25 6 0x02 0x29 0x13 0x00 0xc7 0x90 0x99 0xA9 0xAA 0xAA 0xAA 0xAA 0x99 0x99 0x88 0x88 0x88 0x77 0x66 0x66 0x66 0x55 0x55 0x00>,
			<LCM_FUNC_CMD LCM_UTIL_WRITE_CMD_V1 5 1 0x00 0x23 0x00 0x00>,
			<LCM_FUNC_CMD LCM_UTIL_WRITE_CMD_V1 5 1 0x00 0x23 0xC6 0x13>,
			<LCM_FUNC_CMD LCM_UTIL_WRITE_CMD_V1 25 6 0x02 0x29 0x13 0x00 0xc7 0x90 0x99 0x99 0xAA 0xAA 0xAA 0x9A 0x99 0x99 0x88 0x88 0x88 0x77 0x66 0x66 0x66 0x66 0x55 0x00>,
			<LCM_FUNC_CMD LCM_UTIL_WRITE_CMD_V1 5 1 0x00 0x23 0x00 0x00>,
			<LCM_FUNC_CMD LCM_UTIL_WRITE_CMD_V1 5 1 0x00 0x23 0xC6 0x14>,
			<LCM_FUNC_CMD LCM_UTIL_WRITE_CMD_V1 25 6 0x02 0x29 0x13 0x00 0xc7 0x90 0x99 0x99 0xA9 0xAA 0xAA 0x99 0x99 0x99 0x88 0x88 0x88 0x77 0x66 0x66 0x66 0x66 0x66 0x00>,
			<LCM_FUNC_CMD LCM_UTIL_WRITE_CMD_V1 5 1 0x00 0x23 0x00 0x00>,
			<LCM_FUNC_CMD LCM_UTIL_WRITE_CMD_V1 5 1 0x00 0x23 0xC6 0x15>,
			<LCM_FUNC_CMD LCM_UTIL_WRITE_CMD_V1 25 6 0x02 0x29 0x13 0x00 0xc7 0x90 0x99 0x99 0x99 0xAA 0x9A 0x99 0x99 0x99 0x88 0x88 0x88 0x77 0x77 0x66 0x66 0x66 0x66 0x00>,
			<LCM_FUNC_CMD LCM_UTIL_WRITE_CMD_V1 5 1 0x00 0x23 0x00 0x00>,
			<LCM_FUNC_CMD LCM_UTIL_WRITE_CMD_V1 5 1 0x00 0x23 0xC6 0x16>,
			<LCM_FUNC_CMD LCM_UTIL_WRITE_CMD_V1 25 6 0x02 0x29 0x13 0x00 0xc7 0x90 0x99 0x99 0x99 0xA9 0x99 0x99 0x99 0x99 0x88 0x88 0x88 0x77 0x77 0x77 0x66 0x66 0x66 0x00>,
			<LCM_FUNC_CMD LCM_UTIL_WRITE_CMD_V1 5 1 0x00 0x23 0x00 0x00>,
			<LCM_FUNC_CMD LCM_UTIL_WRITE_CMD_V1 5 1 0x00 0x23 0xC6 0x17>,
			<LCM_FUNC_CMD LCM_UTIL_WRITE_CMD_V1 25 6 0x02 0x29 0x13 0x00 0xc7 0x80 0x99 0x99 0x99 0x99 0x99 0x99 0x99 0x99 0x88 0x88 0x88 0x77 0x77 0x77 0x77 0x66 0x66 0x00>,
			<LCM_FUNC_CMD LCM_UTIL_WRITE_CMD_V1 5 1 0x00 0x23 0x00 0x00>,
			<LCM_FUNC_CMD LCM_UTIL_WRITE_CMD_V1 5 1 0x00 0x23 0xC6 0x18>,
			<LCM_FUNC_CMD LCM_UTIL_WRITE_CMD_V1 25 6 0x02 0x29 0x13 0x00 0xc7 0x80 0x98 0x99 0x99 0x99 0x98 0x99 0x99 0x99 0x88 0x88 0x88 0x77 0x77 0x77 0x77 0x77 0x66 0x00>,
			<LCM_FUNC_CMD LCM_UTIL_WRITE_CMD_V1 5 1 0x00 0x23 0x00 0x00>,
			<LCM_FUNC_CMD LCM_UTIL_WRITE_CMD_V1 5 1 0x00 0x23 0xC6 0x19>,
			<LCM_FUNC_CMD LCM_UTIL_WRITE_CMD_V1 25 6 0x02 0x29 0x13 0x00 0xc7 0x80 0x88 0x99 0x99 0x99 0x88 0x99 0x99 0x99 0x88 0x88 0x88 0x77 0x77 0x77 0x77 0x77 0x77 0x00>,
			<LCM_FUNC_CMD LCM_UTIL_WRITE_CMD_V1 5 1 0x00 0x23 0x00 0x00>,
			<LCM_FUNC_CMD LCM_UTIL_WRITE_CMD_V1 5 1 0x00 0x23 0xC6 0x1A>,
			<LCM_FUNC_CMD LCM_UTIL_WRITE_CMD_V1 25 6 0x02 0x29 0x13 0x00 0xc7 0x80 0x88 0x98 0x99 0x99 0x88 0x98 0x99 0x99 0x88 0x88 0x88 0x88 0x77 0x77 0x77 0x77 0x77 0x00>,
			<LCM_FUNC_CMD LCM_UTIL_WRITE_CMD_V1 5 1 0x00 0x23 0x00 0x00>,
			<LCM_FUNC_CMD LCM_UTIL_WRITE_CMD_V1 5 1 0x00 0x23 0xC6 0x1B>,
			<LCM_FUNC_CMD LCM_UTIL_WRITE_CMD_V1 25 6 0x02 0x29 0x13 0x00 0xc7 0x80 0x88 0x88 0x99 0x99 0x88 0x88 0x99 0x99 0x88 0x88 0x88 0x88 0x88 0x77 0x77 0x77 0x77 0x00>,
			<LCM_FUNC_CMD LCM_UTIL_WRITE_CMD_V1 5 1 0x00 0x23 0x00 0x00>,
			<LCM_FUNC_CMD LCM_UTIL_WRITE_CMD_V1 5 1 0x00 0x23 0xC6 0x1C>,
			<LCM_FUNC_CMD LCM_UTIL_WRITE_CMD_V1 25 6 0x02 0x29 0x13 0x00 0xc7 0x80 0x88 0x88 0x98 0x99 0x88 0x88 0x98 0x99 0x88 0x88 0x88 0x88 0x88 0x88 0x77 0x77 0x77 0x00>,
			<LCM_FUNC_CMD LCM_UTIL_WRITE_CMD_V1 5 1 0x00 0x23 0x00 0x00>,
			<LCM_FUNC_CMD LCM_UTIL_WRITE_CMD_V1 5 1 0x00 0x23 0xC6 0x1D>,
			<LCM_FUNC_CMD LCM_UTIL_WRITE_CMD_V1 25 6 0x02 0x29 0x13 0x00 0xc7 0x80 0x88 0x88 0x88 0x99 0x88 0x88 0x88 0x99 0x88 0x88 0x88 0x88 0x88 0x88 0x88 0x77 0x77 0x00>,
			<LCM_FUNC_CMD LCM_UTIL_WRITE_CMD_V1 5 1 0x00 0x23 0x00 0x00>,
			<LCM_FUNC_CMD LCM_UTIL_WRITE_CMD_V1 5 1 0x00 0x23 0xC6 0x1E>,
			<LCM_FUNC_CMD LCM_UTIL_WRITE_CMD_V1 25 6 0x02 0x29 0x13 0x00 0xc7 0x80 0x88 0x88 0x88 0x98 0x88 0x88 0x88 0x98 0x88 0x88 0x88 0x88 0x88 0x88 0x88 0x78 0x78 0x00>,
			<LCM_FUNC_CMD LCM_UTIL_WRITE_CMD_V1 5 1 0x00 0x23 0x00 0x00>,
			<LCM_FUNC_CMD LCM_UTIL_WRITE_CMD_V1 5 1 0x00 0x23 0xC6 0x1F>,
			<LCM_FUNC_CMD LCM_UTIL_WRITE_CMD_V1 25 6 0x02 0x29 0x13 0x00 0xc7 0x80 0x88 0x88 0x88 0x88 0x88 0x88 0x88 0x88 0x88 0x88 0x88 0x88 0x88 0x88 0x88 0x88 0x88 0x00>,
			<LCM_FUNC_CMD LCM_UTIL_WRITE_CMD_V1 5 1 0x00 0x23 0x00 0x00>,
			<LCM_FUNC_CMD LCM_UTIL_WRITE_CMD_V1 5 1 0x00 0x23 0xC6 0x00>,
			<LCM_FUNC_CMD LCM_UTIL_WRITE_CMD_V1 5 1 0x00 0x23 0x00 0xB1>,
			<LCM_FUNC_CMD LCM_UTIL_WRITE_CMD_V1 5 1 0x00 0x23 0xC6 0x04>,
			<LCM_FUNC_CMD LCM_UTIL_WRITE_CMD_V1 5 1 0x00 0x23 0x00 0xB4>,
			<LCM_FUNC_CMD LCM_UTIL_WRITE_CMD_V1 5 1 0x00 0x23 0xC6 0x12>,
			<LCM_FUNC_CMD LCM_UTIL_WRITE_CMD_V1 5 1 0x00 0x23 0x00 0xD2>,
			<LCM_FUNC_CMD LCM_UTIL_WRITE_CMD_V1 5 1 0x00 0x23 0xB0 0x03>,
			<LCM_FUNC_CMD LCM_UTIL_WRITE_CMD_V1 5 1 0x00 0x23 0x00 0xA0>,
			<LCM_FUNC_CMD LCM_UTIL_WRITE_CMD_V1 5 1 0x00 0x23 0xC1 0x02>,
			<LCM_FUNC_CMD LCM_UTIL_WRITE_CMD_V1 5 1 0x00 0x23 0x00 0x00>,
			<LCM_FUNC_CMD LCM_UTIL_WRITE_CMD_V1 9 2 0x02 0x29 0x04 0x00 0xFF 0xFF 0xFF 0xFF>,
			<LCM_FUNC_CMD LCM_UTIL_WRITE_CMD_V1 5 1 0x00 0x23 0x35 0x00>,
			<LCM_FUNC_CMD LCM_UTIL_WRITE_CMD_V1 5 1 0x00 0x23 0x51 0x00>,
			<LCM_FUNC_CMD LCM_UTIL_WRITE_CMD_V1 5 1 0x00 0x23 0x53 0x24>,
			<LCM_FUNC_CMD LCM_UTIL_WRITE_CMD_V1 5 1 0x00 0x23 0x55 0x01>,
			<LCM_FUNC_CMD LCM_UTIL_WRITE_CMD_V1 5 1 0x00 0x05 0x11 0x00>,
			<LCM_FUNC_UTIL LCM_UTIL_MDELAY 1 120>,
			<LCM_FUNC_CMD LCM_UTIL_WRITE_CMD_V1 5 1 0x00 0x05 0x29 0x00>,
			<LCM_FUNC_UTIL LCM_UTIL_MDELAY 1 10>;

                compare_id = <LCM_FUNC_GPIO LCM_GPIO_MODE 2 LCM_GPIO_MODE_00 GPIO_LCM_PWR2_EN>,
                        <LCM_FUNC_GPIO LCM_GPIO_DIR 2 LCM_GPIO_DIR_OUT GPIO_LCM_PWR2_EN>,
                        <LCM_FUNC_GPIO LCM_GPIO_OUT 2 LCM_GPIO_OUT_ONE GPIO_LCM_PWR2_EN>,
                        <LCM_FUNC_UTIL LCM_UTIL_MDELAY 1 10>, 
			<LCM_FUNC_GPIO LCM_GPIO_MODE 2 LCM_GPIO_MODE_00 GPIO_LCM_RST>,
                        <LCM_FUNC_GPIO LCM_GPIO_DIR 2 LCM_GPIO_DIR_OUT GPIO_LCM_RST>,
                        <LCM_FUNC_GPIO LCM_GPIO_OUT 2 LCM_GPIO_OUT_ZERO GPIO_LCM_RST>,
                        <LCM_FUNC_UTIL LCM_UTIL_MDELAY 1 10>,
                        <LCM_FUNC_GPIO LCM_GPIO_OUT 2 LCM_GPIO_OUT_ONE GPIO_LCM_RST>,
                        <LCM_FUNC_UTIL LCM_UTIL_MDELAY 1 10>,
                        <LCM_FUNC_GPIO LCM_GPIO_OUT 2 LCM_GPIO_OUT_ZERO GPIO_LCM_RST>,
                        <LCM_FUNC_UTIL LCM_UTIL_MDELAY 1 10>,
                        <LCM_FUNC_GPIO LCM_GPIO_OUT 2 LCM_GPIO_OUT_ONE GPIO_LCM_RST>,
                        <LCM_FUNC_UTIL LCM_UTIL_MDELAY 1 10>,
                        <LCM_FUNC_GPIO LCM_GPIO_MODE 2 LCM_GPIO_MODE_00 GPIO_LCM_PWR_EN>,
                        <LCM_FUNC_GPIO LCM_GPIO_DIR 2 LCM_GPIO_DIR_OUT GPIO_LCM_PWR_EN>,
                        <LCM_FUNC_GPIO LCM_GPIO_OUT 2 LCM_GPIO_OUT_ONE GPIO_LCM_PWR_EN>,
                        <LCM_FUNC_UTIL LCM_UTIL_MDELAY 1 10>,
                        <LCM_FUNC_GPIO LCM_GPIO_OUT 2 LCM_GPIO_OUT_ZERO GPIO_LCM_RST>,
                        <LCM_FUNC_UTIL LCM_UTIL_MDELAY 1 10>,
                        <LCM_FUNC_GPIO LCM_GPIO_OUT 2 LCM_GPIO_OUT_ONE GPIO_LCM_RST>,
                        <LCM_FUNC_UTIL LCM_UTIL_MDELAY 1 50>,
                        <LCM_FUNC_CMD LCM_UTIL_WRITE_CMD_V1 5 1 0x00 0x37 0x01 0x00>,
                        <LCM_FUNC_CMD LCM_UTIL_READ_CMD_V2 3 0xDA 0 0x01>;

		suspend = <LCM_FUNC_CMD LCM_UTIL_WRITE_CMD_V2 3 0x28 10 0x00>,
			<LCM_FUNC_CMD LCM_UTIL_WRITE_CMD_V2 3 0x10 120 0x00>,
			<LCM_FUNC_GPIO LCM_GPIO_MODE 2 LCM_GPIO_MODE_00 GPIO_LCM_RST>,
			<LCM_FUNC_GPIO LCM_GPIO_DIR 2 LCM_GPIO_DIR_OUT GPIO_LCM_RST>,
			<LCM_FUNC_GPIO LCM_GPIO_OUT 2 LCM_GPIO_OUT_ZERO GPIO_LCM_RST>,
			<LCM_FUNC_UTIL LCM_UTIL_MDELAY 1 10>,
			<LCM_FUNC_GPIO LCM_GPIO_MODE 2 LCM_GPIO_MODE_00 GPIO_LCM_PWR_EN>,
			<LCM_FUNC_GPIO LCM_GPIO_DIR 2 LCM_GPIO_DIR_OUT GPIO_LCM_PWR_EN>,
			<LCM_FUNC_GPIO LCM_GPIO_OUT 2 LCM_GPIO_OUT_ONE GPIO_LCM_PWR_EN>,
			<LCM_FUNC_UTIL LCM_UTIL_MDELAY 1 10>,
			<LCM_FUNC_GPIO LCM_GPIO_MODE 2 LCM_GPIO_MODE_00 GPIO_LCM_PWR2_EN>,
			<LCM_FUNC_GPIO LCM_GPIO_DIR 2 LCM_GPIO_DIR_OUT GPIO_LCM_PWR2_EN>,
			<LCM_FUNC_GPIO LCM_GPIO_OUT 2 LCM_GPIO_OUT_ONE GPIO_LCM_PWR2_EN>,
			<LCM_FUNC_UTIL LCM_UTIL_MDELAY 1 10>;

		backlight = <LCM_FUNC_CMD LCM_UTIL_WRITE_CMD_V2 3 0x51 1 0xFF>;
	};
	/* LCM standardization end */
};

