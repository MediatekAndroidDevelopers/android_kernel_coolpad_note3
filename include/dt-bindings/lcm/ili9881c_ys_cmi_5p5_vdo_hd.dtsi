/*
 * Mediatek's LCM driver device tree
 *
 * Copyright (c) 2013 MediaTek Co., Ltd.
 *              http://www.mediatek.com
 *
 */

#include "lcm_define.h"

/ {
	/* LCM standardization */
	lcm_params_1 {
		compatible = "mediatek,lcm_params-ili9881c_dsi_ys_cmi_vdo";

		lcm_params-types = <2 0 0 0>;
		/* type, ctrl, lcm_if, lcm_cmd_if */
		lcm_params-resolution = <720 1280>;
		/* width, height */
		lcm_params-io_select_mode;

		lcm_params-dbi-port;
		lcm_params-dbi-clock_freq;
		lcm_params-dbi-data_width;
		lcm_params-dbi-data_format;
		/* color_order, trans_seq, padding, format, width */
		lcm_params-dbi-cpu_write_bits;
		lcm_params-dbi-io_driving_current;
		lcm_params-dbi-msb_io_driving_current;
		lcm_params-dbi-ctrl_io_driving_current;

		lcm_params-dbi-te_mode;
		lcm_params-dbi-te_edge_polarity;
		lcm_params-dbi-te_hs_delay_cnt;
		lcm_params-dbi-te_vs_width_cnt;
		lcm_params-dbi-te_vs_width_cnt_div;

		lcm_params-dbi-serial-params0;
		/* cs_polarity, clk_polarity, clk_phase, is_non_dbi_mode, clock_base, clock_div */
		lcm_params-dbi-serial-params1;
		/* css, csh, rd_1st, rd_2nd, wr_1st, wr_2nd */
		lcm_params-dbi-serial-params2;
		/* sif_1st_pol, sif_sck_def, sif_3wire, sif_sdi sif_div2, sif_hw_cs */
		lcm_params-dbi-parallel-params0;
		/* write_setup, write_hold, write_wait, read_setup */
		lcm_params-dbi-parallel-params1;
		/* read_hold, read_latency, wait_period, cs_high_width */

		lcm_params-dpi-mipi_pll_clk_ref;
		lcm_params-dpi-mipi_pll_clk_div1;
		lcm_params-dpi-mipi_pll_clk_div2;
		lcm_params-dpi-mipi_pll_clk_fbk_div;

		lcm_params-dpi-dpi_clk_div;
		lcm_params-dpi-dpi_clk_duty;
		lcm_params-dpi-PLL_CLOCK;
		lcm_params-dpi-dpi_clock;
		lcm_params-dpi-ssc_disable;
		lcm_params-dpi-ssc_range;

		lcm_params-dpi-width;
		lcm_params-dpi-height;
		lcm_params-dpi-bg_width;
		lcm_params-dpi-bg_height;

		lcm_params-dpi-clk_pol;
		lcm_params-dpi-de_pol;
		lcm_params-dpi-vsync_pol;
		lcm_params-dpi-hsync_pol;
		lcm_params-dpi-hsync_pulse_width;
		lcm_params-dpi-hsync_back_porch;
		lcm_params-dpi-hsync_front_porch;
		lcm_params-dpi-vsync_pulse_width;
		lcm_params-dpi-vsync_back_porch;
		lcm_params-dpi-vsync_front_porch;

		lcm_params-dpi-format;
		lcm_params-dpi-rgb_order;
		lcm_params-dpi-is_serial_output;
		lcm_params-dpi-i2x_en;
		lcm_params-dpi-i2x_edge;
		lcm_params-dpi-embsync;
		lcm_params-dpi-lvds_tx_en;
		lcm_params-dpi-bit_swap;
		lcm_params-dpi-intermediat_buffer_num;
		lcm_params-dpi-io_driving_current;
		lcm_params-dpi-lsb_io_driving_current;

		lcm_params-dsi-mode = <1>;
		lcm_params-dsi-switch_mode;
		lcm_params-dsi-DSI_WMEM_CONTI;
		lcm_params-dsi-DSI_RMEM_CONTI;
		lcm_params-dsi-VC_NUM;
		lcm_params-dsi-lane_num = <4>;
		lcm_params-dsi-data_format = <0 0 0 2>;
		/* color_order, trans_seq, padding, format */
		lcm_params-dsi-intermediat_buffer_num;
		lcm_params-dsi-ps = <2>;
		lcm_params-dsi-word_count;
		lcm_params-dsi-packet_size;

    lcm_params-dsi-vertical_sync_active = <8>;
    lcm_params-dsi-vertical_backporch = <80>;
    lcm_params-dsi-vertical_frontporch = <16>;
		lcm_params-dsi-vertical_frontporch_for_low_power;
		lcm_params-dsi-vertical_active_line = <1280>;
    lcm_params-dsi-horizontal_sync_active = <115>;
    lcm_params-dsi-horizontal_backporch = <30>;
    lcm_params-dsi-horizontal_frontporch =<70>;
		lcm_params-dsi-horizontal_blanking_pixel;
		lcm_params-dsi-horizontal_active_pixel = <720>;
		lcm_params-dsi-horizontal_bllp;
		lcm_params-dsi-line_byte;
		lcm_params-dsi-horizontal_sync_active_byte;
		lcm_params-dsi-horizontal_backportch_byte;
		lcm_params-dsi-horizontal_frontporch_byte;
		lcm_params-dsi-rgb_byte;
		lcm_params-dsi-horizontal_sync_active_word_count;
		lcm_params-dsi-horizontal_backporch_word_count;
		lcm_params-dsi-horizontal_frontporch_word_count;

		lcm_params-dsi-HS_TRAIL = <10>;
		lcm_params-dsi-ZERO;
		lcm_params-dsi-HS_PRPR;
		lcm_params-dsi-LPX;
		lcm_params-dsi-TA_SACK;
		lcm_params-dsi-TA_GET;
		lcm_params-dsi-TA_SURE;
		lcm_params-dsi-TA_GO;
		lcm_params-dsi-CLK_TRAIL;
		lcm_params-dsi-CLK_ZERO;
		lcm_params-dsi-LPX_WAIT;
		lcm_params-dsi-CONT_DET;
		lcm_params-dsi-CLK_HS_PRPR;
		lcm_params-dsi-CLK_HS_POST;
		lcm_params-dsi-DA_HS_EXIT;
		lcm_params-dsi-CLK_HS_EXIT;

		lcm_params-dsi-pll_select;
		lcm_params-dsi-pll_div1;
		lcm_params-dsi-pll_div2;
		lcm_params-dsi-fbk_div;
		lcm_params-dsi-fbk_sel;
		lcm_params-dsi-rg_bir;
		lcm_params-dsi-rg_bic;
		lcm_params-dsi-rg_bp;
    lcm_params-dsi-pll_clock = <246>;
		lcm_params-dsi-dsi_clock;
		lcm_params-dsi-ssc_disable = <1>;
		lcm_params-dsi-ssc_range;
		lcm_params-dsi-compatibility_for_nvk;
		lcm_params-dsi-cont_clock;

		lcm_params-dsi-ufoe_enable;
		lcm_params-dsi-ufoe_params;
		/* compress_ratio, lr_mode_en, vlc_disable, vlc_config */
		lcm_params-dsi-edp_panel;

		lcm_params-dsi-customization_esd_check_enable = <1>;
		lcm_params-dsi-esd_check_enable = <1>;

		lcm_params-dsi-lcm_int_te_monitor;
		lcm_params-dsi-lcm_int_te_period;
		lcm_params-dsi-lcm_ext_te_monitor;
		lcm_params-dsi-lcm_ext_te_enable;

		lcm_params-dsi-noncont_clock = <1>;
		lcm_params-dsi-noncont_clock_period = <2>;
		lcm_params-dsi-clk_lp_per_line_enable;

		lcm_params-dsi-lcm_esd_check_table0 = <0x0a 0x01 0x9c 0x0>;
		lcm_params-dsi-lcm_esd_check_table1;
		lcm_params-dsi-lcm_esd_check_table2;

		lcm_params-dsi-switch_mode_enable;
		lcm_params-dsi-dual_dsi_type;
		lcm_params-dsi-lane_swap_en;
		lcm_params-dsi-lane_swap0;
		/* lane_swap[0][0~5] */
		lcm_params-dsi-lane_swap1;
		/* lane_swap[1][0~5] */
		lcm_params-dsi-vertical_vfp_lp;
		lcm_params-physical_width = <68>;
		lcm_params-physical_height = <121>;
		lcm_params-od_table_size;
		lcm_params-od_table;
	};

	lcm_ops_1 {
		compatible = "mediatek,lcm_ops-ili9881c_dsi_ys_cmi_vdo";

    init = <LCM_FUNC_GPIO LCM_GPIO_MODE 2 LCM_GPIO_MODE_00 GPIO_LCM_PWR_EN>,
    <LCM_FUNC_GPIO LCM_GPIO_DIR 2 LCM_GPIO_DIR_OUT GPIO_LCM_PWR_EN>,
    <LCM_FUNC_GPIO LCM_GPIO_OUT 2 LCM_GPIO_OUT_ONE GPIO_LCM_PWR_EN>,
    <LCM_FUNC_UTIL LCM_UTIL_MDELAY 1 5>,
    <LCM_FUNC_GPIO LCM_GPIO_MODE 2 LCM_GPIO_MODE_00 GPIO_LCM_PWR>,
    <LCM_FUNC_GPIO LCM_GPIO_DIR 2 LCM_GPIO_DIR_OUT GPIO_LCM_PWR>,
    <LCM_FUNC_GPIO LCM_GPIO_OUT 2 LCM_GPIO_OUT_ONE GPIO_LCM_PWR>,
    <LCM_FUNC_UTIL LCM_UTIL_MDELAY 1 10>,
    <LCM_FUNC_GPIO LCM_GPIO_MODE 2 LCM_GPIO_MODE_00 GPIO_LCM_RST>,
    <LCM_FUNC_GPIO LCM_GPIO_DIR 2 LCM_GPIO_DIR_OUT GPIO_LCM_RST>,
    <LCM_FUNC_GPIO LCM_GPIO_OUT 2 LCM_GPIO_OUT_ONE GPIO_LCM_RST>,
    <LCM_FUNC_UTIL LCM_UTIL_MDELAY 1 5>,
    <LCM_FUNC_GPIO LCM_GPIO_OUT 2 LCM_GPIO_OUT_ZERO GPIO_LCM_RST>,
    <LCM_FUNC_UTIL LCM_UTIL_MDELAY 1 10>,
    <LCM_FUNC_GPIO LCM_GPIO_OUT 2 LCM_GPIO_OUT_ONE GPIO_LCM_RST>,
    <LCM_FUNC_UTIL LCM_UTIL_MDELAY 1 20>,
    <LCM_FUNC_CMD LCM_UTIL_WRITE_CMD_V1 9 2 0x02 0x29 0x04 0x00 0xFF 0x98 0x81 0x03>,
    <LCM_FUNC_CMD LCM_UTIL_WRITE_CMD_V1 5 1 0x00 0x23 0x01 0x00>,
    <LCM_FUNC_CMD LCM_UTIL_WRITE_CMD_V1 5 1 0x00 0x23 0x02 0x00>,
    <LCM_FUNC_CMD LCM_UTIL_WRITE_CMD_V1 5 1 0x00 0x23 0x03 0x53>,
    <LCM_FUNC_CMD LCM_UTIL_WRITE_CMD_V1 5 1 0x00 0x23 0x04 0x13>,
    <LCM_FUNC_CMD LCM_UTIL_WRITE_CMD_V1 5 1 0x00 0x23 0x05 0x13>,
    <LCM_FUNC_CMD LCM_UTIL_WRITE_CMD_V1 5 1 0x00 0x23 0x06 0x06>,
    <LCM_FUNC_CMD LCM_UTIL_WRITE_CMD_V1 5 1 0x00 0x23 0x07 0x00>,
    <LCM_FUNC_CMD LCM_UTIL_WRITE_CMD_V1 5 1 0x00 0x23 0x08 0x04>,
    <LCM_FUNC_CMD LCM_UTIL_WRITE_CMD_V1 5 1 0x00 0x23 0x09 0x04>,
    <LCM_FUNC_CMD LCM_UTIL_WRITE_CMD_V1 5 1 0x00 0x23 0x0A 0x03>,
    <LCM_FUNC_CMD LCM_UTIL_WRITE_CMD_V1 5 1 0x00 0x23 0x0B 0x03>,
    <LCM_FUNC_CMD LCM_UTIL_WRITE_CMD_V1 5 1 0x00 0x23 0x0C 0x00>,
    <LCM_FUNC_CMD LCM_UTIL_WRITE_CMD_V1 5 1 0x00 0x23 0x0D 0x00>,
    <LCM_FUNC_CMD LCM_UTIL_WRITE_CMD_V1 5 1 0x00 0x23 0x0E 0x00>,
    <LCM_FUNC_CMD LCM_UTIL_WRITE_CMD_V1 5 1 0x00 0x23 0x0F 0x04>,
    <LCM_FUNC_CMD LCM_UTIL_WRITE_CMD_V1 5 1 0x00 0x23 0x10 0x04>,
    <LCM_FUNC_CMD LCM_UTIL_WRITE_CMD_V1 5 1 0x00 0x23 0x11 0x00>,
    <LCM_FUNC_CMD LCM_UTIL_WRITE_CMD_V1 5 1 0x00 0x23 0x12 0x00>,
    <LCM_FUNC_CMD LCM_UTIL_WRITE_CMD_V1 5 1 0x00 0x23 0x13 0x00>,
    <LCM_FUNC_CMD LCM_UTIL_WRITE_CMD_V1 5 1 0x00 0x23 0x14 0x00>,
    <LCM_FUNC_CMD LCM_UTIL_WRITE_CMD_V1 5 1 0x00 0x23 0x15 0x00>,
    <LCM_FUNC_CMD LCM_UTIL_WRITE_CMD_V1 5 1 0x00 0x23 0x16 0x00>,
    <LCM_FUNC_CMD LCM_UTIL_WRITE_CMD_V1 5 1 0x00 0x23 0x17 0x00>,
    <LCM_FUNC_CMD LCM_UTIL_WRITE_CMD_V1 5 1 0x00 0x23 0x18 0x00>,
    <LCM_FUNC_CMD LCM_UTIL_WRITE_CMD_V1 5 1 0x00 0x23 0x19 0x00>,
    <LCM_FUNC_CMD LCM_UTIL_WRITE_CMD_V1 5 1 0x00 0x23 0x1A 0x00>,
    <LCM_FUNC_CMD LCM_UTIL_WRITE_CMD_V1 5 1 0x00 0x23 0x1B 0x00>,
    <LCM_FUNC_CMD LCM_UTIL_WRITE_CMD_V1 5 1 0x00 0x23 0x1C 0x00>,
    <LCM_FUNC_CMD LCM_UTIL_WRITE_CMD_V1 5 1 0x00 0x23 0x1D 0x00>,
    <LCM_FUNC_CMD LCM_UTIL_WRITE_CMD_V1 5 1 0x00 0x23 0x1E 0xC0>,
    <LCM_FUNC_CMD LCM_UTIL_WRITE_CMD_V1 5 1 0x00 0x23 0x1F 0x80>,
    <LCM_FUNC_CMD LCM_UTIL_WRITE_CMD_V1 5 1 0x00 0x23 0x20 0x04>,
    <LCM_FUNC_CMD LCM_UTIL_WRITE_CMD_V1 5 1 0x00 0x23 0x21 0x0B>,
    <LCM_FUNC_CMD LCM_UTIL_WRITE_CMD_V1 5 1 0x00 0x23 0x22 0x00>,
    <LCM_FUNC_CMD LCM_UTIL_WRITE_CMD_V1 5 1 0x00 0x23 0x23 0x00>,
    <LCM_FUNC_CMD LCM_UTIL_WRITE_CMD_V1 5 1 0x00 0x23 0x24 0x00>,
    <LCM_FUNC_CMD LCM_UTIL_WRITE_CMD_V1 5 1 0x00 0x23 0x25 0x00>,
    <LCM_FUNC_CMD LCM_UTIL_WRITE_CMD_V1 5 1 0x00 0x23 0x26 0x00>,
    <LCM_FUNC_CMD LCM_UTIL_WRITE_CMD_V1 5 1 0x00 0x23 0x27 0x00>,
    <LCM_FUNC_CMD LCM_UTIL_WRITE_CMD_V1 5 1 0x00 0x23 0x28 0x55>,
    <LCM_FUNC_CMD LCM_UTIL_WRITE_CMD_V1 5 1 0x00 0x23 0x29 0x03>,
    <LCM_FUNC_CMD LCM_UTIL_WRITE_CMD_V1 5 1 0x00 0x23 0x2A 0x00>,
    <LCM_FUNC_CMD LCM_UTIL_WRITE_CMD_V1 5 1 0x00 0x23 0x2B 0x00>,
    <LCM_FUNC_CMD LCM_UTIL_WRITE_CMD_V1 5 1 0x00 0x23 0x2C 0x00>,
    <LCM_FUNC_CMD LCM_UTIL_WRITE_CMD_V1 5 1 0x00 0x23 0x2D 0x00>,
    <LCM_FUNC_CMD LCM_UTIL_WRITE_CMD_V1 5 1 0x00 0x23 0x2E 0x00>,
    <LCM_FUNC_CMD LCM_UTIL_WRITE_CMD_V1 5 1 0x00 0x23 0x2F 0x00>,
    <LCM_FUNC_CMD LCM_UTIL_WRITE_CMD_V1 5 1 0x00 0x23 0x30 0x00>,
    <LCM_FUNC_CMD LCM_UTIL_WRITE_CMD_V1 5 1 0x00 0x23 0x31 0x00>,
    <LCM_FUNC_CMD LCM_UTIL_WRITE_CMD_V1 5 1 0x00 0x23 0x32 0x00>,
    <LCM_FUNC_CMD LCM_UTIL_WRITE_CMD_V1 5 1 0x00 0x23 0x33 0x00>,
    <LCM_FUNC_CMD LCM_UTIL_WRITE_CMD_V1 5 1 0x00 0x23 0x34 0x04>,
    <LCM_FUNC_CMD LCM_UTIL_WRITE_CMD_V1 5 1 0x00 0x23 0x35 0x00>,
    <LCM_FUNC_CMD LCM_UTIL_WRITE_CMD_V1 5 1 0x00 0x23 0x36 0x05>,
    <LCM_FUNC_CMD LCM_UTIL_WRITE_CMD_V1 5 1 0x00 0x23 0x37 0x00>,
    <LCM_FUNC_CMD LCM_UTIL_WRITE_CMD_V1 5 1 0x00 0x23 0x38 0x3C>,
    <LCM_FUNC_CMD LCM_UTIL_WRITE_CMD_V1 5 1 0x00 0x23 0x39 0x00>,
    <LCM_FUNC_CMD LCM_UTIL_WRITE_CMD_V1 5 1 0x00 0x23 0x3A 0x40>,
    <LCM_FUNC_CMD LCM_UTIL_WRITE_CMD_V1 5 1 0x00 0x23 0x3B 0x40>,
    <LCM_FUNC_CMD LCM_UTIL_WRITE_CMD_V1 5 1 0x00 0x23 0x3C 0x00>,
    <LCM_FUNC_CMD LCM_UTIL_WRITE_CMD_V1 5 1 0x00 0x23 0x3D 0x00>,
    <LCM_FUNC_CMD LCM_UTIL_WRITE_CMD_V1 5 1 0x00 0x23 0x3E 0x00>,
    <LCM_FUNC_CMD LCM_UTIL_WRITE_CMD_V1 5 1 0x00 0x23 0x3F 0x00>,
    <LCM_FUNC_CMD LCM_UTIL_WRITE_CMD_V1 5 1 0x00 0x23 0x40 0x00>,
    <LCM_FUNC_CMD LCM_UTIL_WRITE_CMD_V1 5 1 0x00 0x23 0x41 0x00>,
    <LCM_FUNC_CMD LCM_UTIL_WRITE_CMD_V1 5 1 0x00 0x23 0x42 0x00>,
    <LCM_FUNC_CMD LCM_UTIL_WRITE_CMD_V1 5 1 0x00 0x23 0x43 0x00>,
    <LCM_FUNC_CMD LCM_UTIL_WRITE_CMD_V1 5 1 0x00 0x23 0x44 0x00>,
    <LCM_FUNC_CMD LCM_UTIL_WRITE_CMD_V1 5 1 0x00 0x23 0x50 0x01>,
    <LCM_FUNC_CMD LCM_UTIL_WRITE_CMD_V1 5 1 0x00 0x23 0x51 0x23>,
    <LCM_FUNC_CMD LCM_UTIL_WRITE_CMD_V1 5 1 0x00 0x23 0x52 0x45>,
    <LCM_FUNC_CMD LCM_UTIL_WRITE_CMD_V1 5 1 0x00 0x23 0x53 0x67>,
    <LCM_FUNC_CMD LCM_UTIL_WRITE_CMD_V1 5 1 0x00 0x23 0x54 0x89>,
    <LCM_FUNC_CMD LCM_UTIL_WRITE_CMD_V1 5 1 0x00 0x23 0x55 0xAB>,
    <LCM_FUNC_CMD LCM_UTIL_WRITE_CMD_V1 5 1 0x00 0x23 0x56 0x01>,
    <LCM_FUNC_CMD LCM_UTIL_WRITE_CMD_V1 5 1 0x00 0x23 0x57 0x23>,
    <LCM_FUNC_CMD LCM_UTIL_WRITE_CMD_V1 5 1 0x00 0x23 0x58 0x45>,
    <LCM_FUNC_CMD LCM_UTIL_WRITE_CMD_V1 5 1 0x00 0x23 0x59 0x67>,
    <LCM_FUNC_CMD LCM_UTIL_WRITE_CMD_V1 5 1 0x00 0x23 0x5A 0x89>,
    <LCM_FUNC_CMD LCM_UTIL_WRITE_CMD_V1 5 1 0x00 0x23 0x5B 0xAB>,
    <LCM_FUNC_CMD LCM_UTIL_WRITE_CMD_V1 5 1 0x00 0x23 0x5C 0xCD>,
    <LCM_FUNC_CMD LCM_UTIL_WRITE_CMD_V1 5 1 0x00 0x23 0x5D 0xEF>,
    <LCM_FUNC_CMD LCM_UTIL_WRITE_CMD_V1 5 1 0x00 0x23 0x5E 0x01>,
    <LCM_FUNC_CMD LCM_UTIL_WRITE_CMD_V1 5 1 0x00 0x23 0x5F 0x14>,
    <LCM_FUNC_CMD LCM_UTIL_WRITE_CMD_V1 5 1 0x00 0x23 0x60 0x15>,
    <LCM_FUNC_CMD LCM_UTIL_WRITE_CMD_V1 5 1 0x00 0x23 0x61 0x0C>,
    <LCM_FUNC_CMD LCM_UTIL_WRITE_CMD_V1 5 1 0x00 0x23 0x62 0x0D>,
    <LCM_FUNC_CMD LCM_UTIL_WRITE_CMD_V1 5 1 0x00 0x23 0x63 0x0E>,
    <LCM_FUNC_CMD LCM_UTIL_WRITE_CMD_V1 5 1 0x00 0x23 0x64 0x0F>,
    <LCM_FUNC_CMD LCM_UTIL_WRITE_CMD_V1 5 1 0x00 0x23 0x65 0x10>,
    <LCM_FUNC_CMD LCM_UTIL_WRITE_CMD_V1 5 1 0x00 0x23 0x66 0x11>,
    <LCM_FUNC_CMD LCM_UTIL_WRITE_CMD_V1 5 1 0x00 0x23 0x67 0x08>,
    <LCM_FUNC_CMD LCM_UTIL_WRITE_CMD_V1 5 1 0x00 0x23 0x68 0x02>,
    <LCM_FUNC_CMD LCM_UTIL_WRITE_CMD_V1 5 1 0x00 0x23 0x69 0x0A>,
    <LCM_FUNC_CMD LCM_UTIL_WRITE_CMD_V1 5 1 0x00 0x23 0x6A 0x02>,
    <LCM_FUNC_CMD LCM_UTIL_WRITE_CMD_V1 5 1 0x00 0x23 0x6B 0x02>,
    <LCM_FUNC_CMD LCM_UTIL_WRITE_CMD_V1 5 1 0x00 0x23 0x6C 0x02>,
    <LCM_FUNC_CMD LCM_UTIL_WRITE_CMD_V1 5 1 0x00 0x23 0x6D 0x02>,
    <LCM_FUNC_CMD LCM_UTIL_WRITE_CMD_V1 5 1 0x00 0x23 0x6E 0x02>,
    <LCM_FUNC_CMD LCM_UTIL_WRITE_CMD_V1 5 1 0x00 0x23 0x6F 0x02>,
    <LCM_FUNC_CMD LCM_UTIL_WRITE_CMD_V1 5 1 0x00 0x23 0x70 0x02>,
    <LCM_FUNC_CMD LCM_UTIL_WRITE_CMD_V1 5 1 0x00 0x23 0x71 0x02>,
    <LCM_FUNC_CMD LCM_UTIL_WRITE_CMD_V1 5 1 0x00 0x23 0x72 0x06>,
    <LCM_FUNC_CMD LCM_UTIL_WRITE_CMD_V1 5 1 0x00 0x23 0x73 0x02>,
    <LCM_FUNC_CMD LCM_UTIL_WRITE_CMD_V1 5 1 0x00 0x23 0x74 0x02>,
    <LCM_FUNC_CMD LCM_UTIL_WRITE_CMD_V1 5 1 0x00 0x23 0x75 0x14>,
    <LCM_FUNC_CMD LCM_UTIL_WRITE_CMD_V1 5 1 0x00 0x23 0x76 0x15>,
    <LCM_FUNC_CMD LCM_UTIL_WRITE_CMD_V1 5 1 0x00 0x23 0x77 0x11>,
    <LCM_FUNC_CMD LCM_UTIL_WRITE_CMD_V1 5 1 0x00 0x23 0x78 0x10>,
    <LCM_FUNC_CMD LCM_UTIL_WRITE_CMD_V1 5 1 0x00 0x23 0x79 0x0F>,
    <LCM_FUNC_CMD LCM_UTIL_WRITE_CMD_V1 5 1 0x00 0x23 0x7A 0x0E>,
    <LCM_FUNC_CMD LCM_UTIL_WRITE_CMD_V1 5 1 0x00 0x23 0x7B 0x0D>,
    <LCM_FUNC_CMD LCM_UTIL_WRITE_CMD_V1 5 1 0x00 0x23 0x7C 0x0C>,
    <LCM_FUNC_CMD LCM_UTIL_WRITE_CMD_V1 5 1 0x00 0x23 0x7D 0x06>,
    <LCM_FUNC_CMD LCM_UTIL_WRITE_CMD_V1 5 1 0x00 0x23 0x7E 0x02>,
    <LCM_FUNC_CMD LCM_UTIL_WRITE_CMD_V1 5 1 0x00 0x23 0x7F 0x0A>,
    <LCM_FUNC_CMD LCM_UTIL_WRITE_CMD_V1 5 1 0x00 0x23 0x80 0x02>,
    <LCM_FUNC_CMD LCM_UTIL_WRITE_CMD_V1 5 1 0x00 0x23 0x81 0x02>,
    <LCM_FUNC_CMD LCM_UTIL_WRITE_CMD_V1 5 1 0x00 0x23 0x82 0x02>,
    <LCM_FUNC_CMD LCM_UTIL_WRITE_CMD_V1 5 1 0x00 0x23 0x83 0x02>,
    <LCM_FUNC_CMD LCM_UTIL_WRITE_CMD_V1 5 1 0x00 0x23 0x84 0x02>,
    <LCM_FUNC_CMD LCM_UTIL_WRITE_CMD_V1 5 1 0x00 0x23 0x85 0x02>,
    <LCM_FUNC_CMD LCM_UTIL_WRITE_CMD_V1 5 1 0x00 0x23 0x86 0x02>,
    <LCM_FUNC_CMD LCM_UTIL_WRITE_CMD_V1 5 1 0x00 0x23 0x87 0x02>,
    <LCM_FUNC_CMD LCM_UTIL_WRITE_CMD_V1 5 1 0x00 0x23 0x88 0x08>,
    <LCM_FUNC_CMD LCM_UTIL_WRITE_CMD_V1 5 1 0x00 0x23 0x89 0x02>,
    <LCM_FUNC_CMD LCM_UTIL_WRITE_CMD_V1 5 1 0x00 0x23 0x8A 0x02>,
    <LCM_FUNC_CMD LCM_UTIL_WRITE_CMD_V1 9 2 0x02 0x29 0x04 0x00 0xFF 0x98 0x81 0x04>,
    <LCM_FUNC_CMD LCM_UTIL_WRITE_CMD_V1 5 1 0x00 0x23 0x70 0x00>,
    <LCM_FUNC_CMD LCM_UTIL_WRITE_CMD_V1 5 1 0x00 0x23 0x71 0x30>,
    <LCM_FUNC_CMD LCM_UTIL_WRITE_CMD_V1 5 1 0x00 0x23 0x34 0x83>,
    <LCM_FUNC_CMD LCM_UTIL_WRITE_CMD_V1 5 1 0x00 0x23 0x6C 0x15>,
    <LCM_FUNC_CMD LCM_UTIL_WRITE_CMD_V1 5 1 0x00 0x23 0x6E 0x30>,
    <LCM_FUNC_CMD LCM_UTIL_WRITE_CMD_V1 5 1 0x00 0x23 0x6F 0x45>,
    <LCM_FUNC_CMD LCM_UTIL_WRITE_CMD_V1 5 1 0x00 0x23 0x3A 0xA4>,
    <LCM_FUNC_CMD LCM_UTIL_WRITE_CMD_V1 5 1 0x00 0x23 0x8D 0x1F>,
    <LCM_FUNC_CMD LCM_UTIL_WRITE_CMD_V1 5 1 0x00 0x23 0x87 0xBA>,
    <LCM_FUNC_CMD LCM_UTIL_WRITE_CMD_V1 5 1 0x00 0x23 0x26 0x76>,
    <LCM_FUNC_CMD LCM_UTIL_WRITE_CMD_V1 5 1 0x00 0x23 0xB2 0xD1>,
    <LCM_FUNC_CMD LCM_UTIL_WRITE_CMD_V1 5 1 0x00 0x23 0x88 0x0B>,
    <LCM_FUNC_CMD LCM_UTIL_WRITE_CMD_V1 9 2 0x02 0x29 0x04 0x00 0xFF 0x98 0x81 0x01>,
    <LCM_FUNC_CMD LCM_UTIL_WRITE_CMD_V1 5 1 0x00 0x23 0x42 0x33>,
    <LCM_FUNC_CMD LCM_UTIL_WRITE_CMD_V1 5 1 0x00 0x23 0x22 0x0A>,
    <LCM_FUNC_CMD LCM_UTIL_WRITE_CMD_V1 5 1 0x00 0x23 0x31 0x00>,
    <LCM_FUNC_CMD LCM_UTIL_WRITE_CMD_V1 5 1 0x00 0x23 0x53 0x5E>,
    <LCM_FUNC_CMD LCM_UTIL_WRITE_CMD_V1 5 1 0x00 0x23 0x55 0x99>,
    <LCM_FUNC_CMD LCM_UTIL_WRITE_CMD_V1 5 1 0x00 0x23 0x50 0xA0>,
    <LCM_FUNC_CMD LCM_UTIL_WRITE_CMD_V1 5 1 0x00 0x23 0x51 0xA0>,
    <LCM_FUNC_CMD LCM_UTIL_WRITE_CMD_V1 5 1 0x00 0x23 0x60 0x14>,
    <LCM_FUNC_CMD LCM_UTIL_WRITE_CMD_V1 5 1 0x00 0x23 0xA0 0x18>,
    <LCM_FUNC_CMD LCM_UTIL_WRITE_CMD_V1 5 1 0x00 0x23 0xA1 0x2F>,
    <LCM_FUNC_CMD LCM_UTIL_WRITE_CMD_V1 5 1 0x00 0x23 0xA2 0x3E>,
    <LCM_FUNC_CMD LCM_UTIL_WRITE_CMD_V1 5 1 0x00 0x23 0xA3 0x11>,
    <LCM_FUNC_CMD LCM_UTIL_WRITE_CMD_V1 5 1 0x00 0x23 0xA4 0x16>,
    <LCM_FUNC_CMD LCM_UTIL_WRITE_CMD_V1 5 1 0x00 0x23 0xA5 0x2A>,
    <LCM_FUNC_CMD LCM_UTIL_WRITE_CMD_V1 5 1 0x00 0x23 0xA6 0x1F>,
    <LCM_FUNC_CMD LCM_UTIL_WRITE_CMD_V1 5 1 0x00 0x23 0xA7 0x20>,
    <LCM_FUNC_CMD LCM_UTIL_WRITE_CMD_V1 5 1 0x00 0x23 0xA8 0xAA>,
    <LCM_FUNC_CMD LCM_UTIL_WRITE_CMD_V1 5 1 0x00 0x23 0xA9 0x1C>,
    <LCM_FUNC_CMD LCM_UTIL_WRITE_CMD_V1 5 1 0x00 0x23 0xAA 0x2A>,
    <LCM_FUNC_CMD LCM_UTIL_WRITE_CMD_V1 5 1 0x00 0x23 0xAB 0x8E>,
    <LCM_FUNC_CMD LCM_UTIL_WRITE_CMD_V1 5 1 0x00 0x23 0xAC 0x1D>,
    <LCM_FUNC_CMD LCM_UTIL_WRITE_CMD_V1 5 1 0x00 0x23 0xAD 0x1C>,
    <LCM_FUNC_CMD LCM_UTIL_WRITE_CMD_V1 5 1 0x00 0x23 0xAE 0x50>,
    <LCM_FUNC_CMD LCM_UTIL_WRITE_CMD_V1 5 1 0x00 0x23 0xAF 0x24>,
    <LCM_FUNC_CMD LCM_UTIL_WRITE_CMD_V1 5 1 0x00 0x23 0xB0 0x2B>,
    <LCM_FUNC_CMD LCM_UTIL_WRITE_CMD_V1 5 1 0x00 0x23 0xB1 0x4B>,
    <LCM_FUNC_CMD LCM_UTIL_WRITE_CMD_V1 5 1 0x00 0x23 0xB2 0x55>,
    <LCM_FUNC_CMD LCM_UTIL_WRITE_CMD_V1 5 1 0x00 0x23 0xB3 0x2C>,
    <LCM_FUNC_CMD LCM_UTIL_WRITE_CMD_V1 5 1 0x00 0x23 0xC0 0x08>,
    <LCM_FUNC_CMD LCM_UTIL_WRITE_CMD_V1 5 1 0x00 0x23 0xC1 0x2F>,
    <LCM_FUNC_CMD LCM_UTIL_WRITE_CMD_V1 5 1 0x00 0x23 0xC2 0x3E>,
    <LCM_FUNC_CMD LCM_UTIL_WRITE_CMD_V1 5 1 0x00 0x23 0xC3 0x12>,
    <LCM_FUNC_CMD LCM_UTIL_WRITE_CMD_V1 5 1 0x00 0x23 0xC4 0x16>,
    <LCM_FUNC_CMD LCM_UTIL_WRITE_CMD_V1 5 1 0x00 0x23 0xC5 0x29>,
    <LCM_FUNC_CMD LCM_UTIL_WRITE_CMD_V1 5 1 0x00 0x23 0xC6 0x1F>,
    <LCM_FUNC_CMD LCM_UTIL_WRITE_CMD_V1 5 1 0x00 0x23 0xC7 0x1F>,
    <LCM_FUNC_CMD LCM_UTIL_WRITE_CMD_V1 5 1 0x00 0x23 0xC8 0xAB>,
    <LCM_FUNC_CMD LCM_UTIL_WRITE_CMD_V1 5 1 0x00 0x23 0xC9 0x1D>,
    <LCM_FUNC_CMD LCM_UTIL_WRITE_CMD_V1 5 1 0x00 0x23 0xCA 0x2B>,
    <LCM_FUNC_CMD LCM_UTIL_WRITE_CMD_V1 5 1 0x00 0x23 0xCB 0x8F>,
    <LCM_FUNC_CMD LCM_UTIL_WRITE_CMD_V1 5 1 0x00 0x23 0xCC 0x1D>,
    <LCM_FUNC_CMD LCM_UTIL_WRITE_CMD_V1 5 1 0x00 0x23 0xCD 0x1B>,
    <LCM_FUNC_CMD LCM_UTIL_WRITE_CMD_V1 5 1 0x00 0x23 0xCE 0x50>,
    <LCM_FUNC_CMD LCM_UTIL_WRITE_CMD_V1 5 1 0x00 0x23 0xCF 0x25>,
    <LCM_FUNC_CMD LCM_UTIL_WRITE_CMD_V1 5 1 0x00 0x23 0xD0 0x2B>,
    <LCM_FUNC_CMD LCM_UTIL_WRITE_CMD_V1 5 1 0x00 0x23 0xD1 0x4B>,
    <LCM_FUNC_CMD LCM_UTIL_WRITE_CMD_V1 5 1 0x00 0x23 0xD2 0x55>,
    <LCM_FUNC_CMD LCM_UTIL_WRITE_CMD_V1 5 1 0x00 0x23 0xD3 0x2C>,
    <LCM_FUNC_CMD LCM_UTIL_WRITE_CMD_V1 9 2 0x02 0x29 0x04 0x00 0xFF 0x98 0x81 0x02>,
    <LCM_FUNC_CMD LCM_UTIL_WRITE_CMD_V1 5 1 0x00 0x23 0x06 0x30>,
    <LCM_FUNC_CMD LCM_UTIL_WRITE_CMD_V1 5 1 0x00 0x23 0x07 0x01>,
    <LCM_FUNC_CMD LCM_UTIL_WRITE_CMD_V1 9 2 0x02 0x29 0x04 0x00 0xFF 0x98 0x81 0x00>,
    <LCM_FUNC_CMD LCM_UTIL_WRITE_CMD_V1 5  1  0x00 0x23 0x35 0x00>,
    <LCM_FUNC_CMD LCM_UTIL_WRITE_CMD_V1 5  1  0x00 0x23 0x51 0x00>,
    <LCM_FUNC_CMD LCM_UTIL_WRITE_CMD_V1 5  1  0x00 0x23 0x53 0x24>,
    <LCM_FUNC_CMD LCM_UTIL_WRITE_CMD_V1 5  1  0x00 0x23 0x55 0x00>,
    <LCM_FUNC_CMD LCM_UTIL_WRITE_CMD_V1 5  1  0x00 0x05 0x11 0x00>,
    <LCM_FUNC_UTIL LCM_UTIL_MDELAY 1 120>,
    <LCM_FUNC_CMD LCM_UTIL_WRITE_CMD_V1 5  1  0x00 0x05 0x29 0x00>,
    <LCM_FUNC_UTIL LCM_UTIL_MDELAY 1 20>;
			
		compare_id = <LCM_FUNC_GPIO LCM_GPIO_MODE 2 LCM_GPIO_MODE_00 GPIO_LCM_PWR2_EN>,
			<LCM_FUNC_GPIO LCM_GPIO_DIR 2 LCM_GPIO_DIR_OUT GPIO_LCM_PWR2_EN>,
			<LCM_FUNC_GPIO LCM_GPIO_OUT 2 LCM_GPIO_OUT_ONE GPIO_LCM_PWR2_EN>,
			<LCM_FUNC_UTIL LCM_UTIL_MDELAY 1 10>,
			<LCM_FUNC_GPIO LCM_GPIO_MODE 2 LCM_GPIO_MODE_00 GPIO_LCM_RST>,
			<LCM_FUNC_GPIO LCM_GPIO_DIR 2 LCM_GPIO_DIR_OUT GPIO_LCM_RST>,
			<LCM_FUNC_GPIO LCM_GPIO_OUT 2 LCM_GPIO_OUT_ZERO GPIO_LCM_RST>,
			<LCM_FUNC_UTIL LCM_UTIL_MDELAY 1 10>,
			<LCM_FUNC_GPIO LCM_GPIO_MODE 2 LCM_GPIO_MODE_00 GPIO_LCM_PWR_EN>,
			<LCM_FUNC_GPIO LCM_GPIO_DIR 2 LCM_GPIO_DIR_OUT GPIO_LCM_PWR_EN>,
			<LCM_FUNC_GPIO LCM_GPIO_OUT 2 LCM_GPIO_OUT_ONE GPIO_LCM_PWR_EN>,
			<LCM_FUNC_UTIL LCM_UTIL_MDELAY 1 3>,
			<LCM_FUNC_GPIO LCM_GPIO_MODE 2 LCM_GPIO_MODE_00 GPIO_LCM_PWR>,
			<LCM_FUNC_GPIO LCM_GPIO_DIR 2 LCM_GPIO_DIR_OUT GPIO_LCM_PWR>,
			<LCM_FUNC_GPIO LCM_GPIO_OUT 2 LCM_GPIO_OUT_ONE GPIO_LCM_PWR>,
			<LCM_FUNC_UTIL LCM_UTIL_MDELAY 1 5>,			
			<LCM_FUNC_GPIO LCM_GPIO_OUT 2 LCM_GPIO_OUT_ONE GPIO_LCM_RST>,
			<LCM_FUNC_UTIL LCM_UTIL_MDELAY 1 52>,
            <LCM_FUNC_CMD LCM_UTIL_WRITE_CMD_V1 5 1 0x00 0x37 0x01 0x00>,
            <LCM_FUNC_CMD LCM_UTIL_READ_CMD_V2 3 0xDA 0 0x11>;

    suspend = <LCM_FUNC_CMD LCM_UTIL_WRITE_CMD_V1 5 1 0x00 0x05 0x28 0x00>,
    <LCM_FUNC_UTIL LCM_UTIL_MDELAY 1 20>,
    <LCM_FUNC_CMD LCM_UTIL_WRITE_CMD_V1 5 1 0x00 0x05 0x10 0x00>,
    <LCM_FUNC_UTIL LCM_UTIL_MDELAY 1 120>,
    <LCM_FUNC_GPIO LCM_GPIO_MODE 2 LCM_GPIO_MODE_00 GPIO_LCM_RST>,
    <LCM_FUNC_GPIO LCM_GPIO_DIR 2 LCM_GPIO_DIR_OUT GPIO_LCM_RST>,
    <LCM_FUNC_GPIO LCM_GPIO_OUT 2 LCM_GPIO_OUT_ZERO GPIO_LCM_RST>,
    <LCM_FUNC_UTIL LCM_UTIL_MDELAY 1 5>,
    <LCM_FUNC_GPIO LCM_GPIO_MODE 2 LCM_GPIO_MODE_00 GPIO_LCM_PWR>,
    <LCM_FUNC_GPIO LCM_GPIO_DIR 2 LCM_GPIO_DIR_OUT GPIO_LCM_PWR>,
    <LCM_FUNC_GPIO LCM_GPIO_OUT 2 LCM_GPIO_OUT_ZERO GPIO_LCM_PWR>,
    <LCM_FUNC_UTIL LCM_UTIL_MDELAY 1 5>,
    <LCM_FUNC_GPIO LCM_GPIO_MODE 2 LCM_GPIO_MODE_00 GPIO_LCM_PWR_EN>,
    <LCM_FUNC_GPIO LCM_GPIO_DIR 2 LCM_GPIO_DIR_OUT GPIO_LCM_PWR_EN>,
    <LCM_FUNC_GPIO LCM_GPIO_OUT 2 LCM_GPIO_OUT_ZERO GPIO_LCM_PWR_EN>,
    <LCM_FUNC_UTIL LCM_UTIL_MDELAY 1 10>;

		backlight = <LCM_FUNC_CMD LCM_UTIL_WRITE_CMD_V2 4 0x51 2  0x0F 0xFF>;
	};
	/* LCM standardization end */
};

